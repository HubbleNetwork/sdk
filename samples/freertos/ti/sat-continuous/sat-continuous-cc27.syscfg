/**
 * @cliArgs --board "/ti/boards/LP_EM_CC2755P10" --rtos "freertos" --product "simplelink_lowpower_f3_sdk@9.20.00.81"
 * @versions {"tool":"1.26.3+4529"}
 */

/**
 * Import the modules used in this configuration.
 */
const FreeRTOS = scripting.addModule("/freertos/FreeRTOS");
const CCFG     = scripting.addModule("/ti/devices/CCFG");
const rfdesign = scripting.addModule("/ti/devices/radioconfig/rfdesign");
const GPIO     = scripting.addModule("/ti/drivers/GPIO");
const UART2    = scripting.addModule("/ti/drivers/UART2", {}, false);
const UART21   = UART2.addInstance();
const Settings = scripting.addModule("/ti/posix/freertos/Settings");
const Hubble = scripting.addModule("/Hubble");

/* ======== AESCCM ======== */
var AESCCM = scripting.addModule("/ti/drivers/AESCCM");
var aesccm = AESCCM.addInstance();
aesccm.$name = "CONFIG_AESCCM0";

/* ======== AESECB ======== */
var AESECB = scripting.addModule("/ti/drivers/AESECB");
var aesecb = AESECB.addInstance();
aesecb.$name = "CONFIG_AESECB0";

/* ======== AESCMAC ======== */
var AESCMAC = scripting.addModule("/ti/drivers/AESCMAC");
var aescmac = AESCMAC.addInstance();
aescmac.$name = "CONFIG_AESCMAC0";

/* ======== AESCTR ======== */
var AESCTR = scripting.addModule("/ti/drivers/AESCTR");
var aescmac = AESCTR.addInstance();
aescmac.$name = "CONFIG_AESCTR0";

Hubble.useTerrestrial = false;
Hubble.useSatellite = true;
Hubble.counterSource = "device-uptime";

var hubble_radio = system.getScript("/hubble_radio.js");
hubble_radio.config();

/**
 * Write custom configuration values to the imported modules.
 */
CCFG.ccfgTemplate.$name = "ti_devices_CCFG_CCFGCC23X0Template0";


UART21.$name = "CONFIG_UART2_0";

/**
 * References between modules.
 */
CCFG.defaultLfoscCompProfile = null;

/**
 * Pinmux solution for unlocked pins/peripherals. This ensures that minor changes to the automatic solver in a future
 * version of the tool will not impact the pinmux you originally saw.  These lines can be completely deleted in order to
 * re-solve from scratch.
 */
UART21.uart.$suggestSolution              = "UART1";
UART21.uart.dmaTxChannel.$suggestSolution = "DMA_CH1";
UART21.uart.dmaRxChannel.$suggestSolution = "DMA_CH0";
UART21.uart.txPin.$suggestSolution        = "boosterpack.2";
UART21.uart.rxPin.$suggestSolution        = "boosterpack.6";
