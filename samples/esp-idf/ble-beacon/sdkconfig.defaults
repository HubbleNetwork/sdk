## samples/esp-idf/ble-beacon/sdkconfig.defaults
```kconfig
# Copyright (c) 2025 Hubble Network, Inc.
# SPDX-License-Identifier: Apache-2.0

CONFIG_BT_ENABLED=y
CONFIG_BT_BLE_50_FEATURES_SUPPORTED=n
CONFIG_BT_BLE_42_FEATURES_SUPPORTED=y


# Hubble
CONFIG_HUBBLE_BLE_NETWORK=y
```

## samples/esp-idf/sat-gnss/sdkconfig.defaults
```kconfig
# Copyright (c) 2025 Hubble Network, Inc.
# SPDX-License-Identifier: Apache-2.0

# Hubble
CONFIG_HUBBLE_SAT_NETWORK=y
```

## tests/zephyr/ble-network/testcase.yaml
```yaml
common:
  platform_allow:
    - nrf52840dk/nrf52840
    - nrf52_bsim
    - native_sim/native/64
  tags:
    - ble
    - security
    - nonce
  integration_platforms:
    - nrf52840dk/nrf52840

tests:
  ble.nonce:
    extra_configs:
      - CONFIG_HUBBLE_BLE_NETWORK_MBEDTLS=y
      - CONFIG_HUBBLE_EID_UTC_BASED=y
  ble.nonce.psa:
    extra_configs:
      - CONFIG_HUBBLE_BLE_NETWORK_PSA=y
      - CONFIG_HUBBLE_EID_UTC_BASED=y
  ble.counter:
    extra_configs:
      - CONFIG_HUBBLE_BLE_NETWORK_MBEDTLS=y
      - CONFIG_HUBBLE_EID_COUNTER_BASED=y
      - CONFIG_HUBBLE_EID_ROTATION_PERIOD_SEC=3600
      - CONFIG_HUBBLE_EID_COUNTER_BITS=8
      - CONFIG_HUBBLE_NETWORK_SEQUENCE_NONCE_CUSTOM=y
  ble.counter.psa:
    extra_configs:
      - CONFIG_HUBBLE_BLE_NETWORK_PSA=y
      - CONFIG_HUBBLE_EID_COUNTER_BASED=y
      - CONFIG_HUBBLE_EID_ROTATION_PERIOD_SEC=3600
      - CONFIG_HUBBLE_EID_COUNTER_BITS=8
      - CONFIG_HUBBLE_NETWORK_SEQUENCE_NONCE_CUSTOM=y
```

## tests/zephyr/ephemeris/testcase.yaml
```yaml
tests:
  satellite.ephemeris:
    min_flash: 34
    tags:
      - ephemeris
      - satellite
    integration_platforms:
      - native_sim
```

## tests/zephyr/sat-api/testcase.yaml
```yaml
common:
  platform_allow:
    - native_sim
    - qemu_x86
  tags:
    - satellite
    - apis

tests:
  satellite.api:
    extra_configs:
      - CONFIG_HUBBLE_SAT_NETWORK_PROTOCOL_V1=y
  satellite.api.deprecated:
    extra_configs:
      - CONFIG_HUBBLE_SAT_NETWORK_PROTOCOL_DEPRECATED=y
```

## tests/zephyr/unit/ble-advertise/testcase.yaml
```yaml
common:
  platform_allow:
    - native_sim
    - native_sim/native/64
    - qemu_cortex_m3
  tags:
    - ble
    - crypto
    - advertise
    - unit

tests:
  ble.advertise.unit.mbedtls:
    extra_configs:
      - CONFIG_HUBBLE_BLE_NETWORK_MBEDTLS=y

  ble.advertise.unit.psa:
    extra_configs:
      - CONFIG_HUBBLE_BLE_NETWORK_PSA=y
```

## tests/zephyr/unit/ble-decrypt/testcase.yaml
```yaml
common:
  platform_allow:
    - native_sim
    - qemu_cortex_m3
  tags:
    - ble
    - crypto
    - decrypt
    - unit

tests:
  ble.decrypt.unit.mbedtls:
    extra_configs:
      - CONFIG_HUBBLE_BLE_NETWORK_MBEDTLS=y

  ble.decrypt.unit.psa:
    extra_configs:
      - CONFIG_HUBBLE_BLE_NETWORK_PSA=y
```

## west.yml
```yaml
# Copyright (c) 2025 Hubble Network, Inc.
# SPDX-License-Identifier: Apache-2.0

manifest:
  remotes:
    - name: zephyrproject-rtos
      url-base: https://github.com/zephyrproject-rtos

  projects:
    - name: zephyr
      remote: zephyrproject-rtos
      revision: v4.2.0
      import: true
      west-commands: scripts/west-commands.yml

  self:
    path: modules/lib/hubblenetwork-sdk
```
