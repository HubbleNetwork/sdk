## CMakeLists.txt
```
# Copyright (c) 2024 Hubble Network, Inc.
# SPDX-License-Identifier: Apache-2.0

cmake_minimum_required(VERSION 3.13.1)
find_package(Zephyr REQUIRED HINTS $ENV{ZEPHYR_BASE})

project(app LANGUAGES C)

target_sources(app PRIVATE src/main.c)
```

## Kconfig
```
# Copyright (c) 2024 Hubble Network, Inc.
# SPDX-License-Identifier: Apache-2.0
#
# This file is the application Kconfig entry point. All application Kconfig
# options can be defined here or included via other application Kconfig files.
# You can browse these options using the west targets menuconfig (terminal) or
# guiconfig (GUI).

menu "Zephyr"
source "Kconfig.zephyr"
endmenu

module = APP
module-str = APP
source "subsys/logging/Kconfig.template.log_config"
```

## sample.yaml
```
# This file is provided so that the application can be compiled using Twister,
# the Zephyr testing tool.
sample:
  description: Hubble Network Bluetooth Example application
  name: hubble-ble-network-application
common:
  build_only: true
  depends_on:
    - ble
  integration_platforms:
    - nrf52840dk/nrf52840
tests:
  app.ble_network.default: {}
  app.ble_network.128key:
    extra_configs:
      - CONFIG_HUBBLE_NETWORK_KEY_128=y
  app.ble_network.debug:
    extra_overlay_confs:
      - debug.conf
  app.ble_network.mbedtls:
    extra_configs:
      - CONFIG_HUBBLE_BLE_NETWORK_MBEDTLS=y
  app.ble_network.mbedtls_128key:
    extra_configs:
      - CONFIG_HUBBLE_BLE_NETWORK_MBEDTLS=y
      - CONFIG_HUBBLE_NETWORK_KEY_128=y
```

## prj.conf
```kconfig
# Copyright (c) 2024 Hubble Network, Inc.
# SPDX-License-Identifier: Apache-2.0

# Hubble Network
CONFIG_HUBBLE_BLE_NETWORK=y
CONFIG_HUBBLE_BLE_HELPER=y

# Bluetooth dependencies
CONFIG_BT=y
CONFIG_BT_PERIPHERAL=y
CONFIG_BT_EXT_ADV=y

# Shell integration. Useful for provision device's key.
CONFIG_SHELL=y
```

## debug.conf
```kconfig
# Copyright (c) 2024 Hubble Network, Inc.
# SPDX-License-Identifier: Apache-2.0
#
# compiler
CONFIG_DEBUG_OPTIMIZATIONS=y

# logging
CONFIG_LOG=y
CONFIG_APP_LOG_LEVEL_DBG=y
```

## src/main.c
```c
/*
 * Copyright (c) 2024 Hubble Network, Inc.
 * SPDX-License-Identifier: Apache-2.0
 */

#include <hubble/hubble.h>

#include <zephyr/kernel.h>
#include <zephyr/bluetooth/bluetooth.h>
#include <zephyr/logging/log.h>
#include <zephyr/random/random.h>
#include <zephyr/shell/shell.h>

#include <app_version.h>

#include <stdlib.h>

LOG_MODULE_REGISTER(main, CONFIG_APP_LOG_LEVEL);
K_SEM_DEFINE(app_sem, 0, 1);
K_SEM_DEFINE(key_sem, 0, 1);

// Buffer used for Hubble data
// Encrypted data will go in here for the advertisement.
#define HUBBLE_USER_BUFFER_LEN 31
static uint8_t _hubble_user_buffer[HUBBLE_USER_BUFFER_LEN];

static uint8_t master_key[CONFIG_HUBBLE_KEY_SIZE];
static uint64_t utc_time;
static int sum;
static int chunk_element;
static char chunk[2];
static uint16_t app_adv_uuids = HUBBLE_BLE_UUID;
static struct bt_data app_ad[2] = {
	BT_DATA(BT_DATA_UUID16_ALL, &app_adv_uuids, sizeof(app_adv_uuids)),
	{},
};


static inline bool is_hexchar(uint8_t data)
{
	return (data >= 0x30 && data <= 0x39) ||
	       (data >= 0x61 && data <= 0x66) || (data >= 0x41 && data <= 0x46);
}

static void bypass_cb(const struct shell *sh, uint8_t *recv, size_t len)
{
	bool escape = false;
	static uint8_t tail;
	uint8_t byte;

#define CHAR_CAN 0x18
#define CHAR_DC1 0x11
	if (tail == CHAR_CAN && recv[0] == CHAR_DC1) {
		escape = true;
	} else {
		for (int i = 0; i < (len - 1); i++) {
			if (recv[i] == CHAR_CAN && recv[i + 1] == CHAR_DC1) {
				escape = true;
				break;
			}
		}
	}
#undef CHAR_CAN
#undef CHAR_DC1

	if (sum > sizeof(master_key)) {
		shell_print(sh, "Given key is too big !");
		shell_set_bypass(sh, NULL);
		if (hubble_key_set((void *)master_key) != 0) {
			LOG_WRN("Failed to set the encryption key");
		}

		return;
	}

	if (escape) {
		shell_print(sh, "Number of bytes read: %d", sum);
		shell_set_bypass(sh, NULL);
		if (hubble_key_set((void *)master_key) != 0) {
			LOG_WRN("Failed to set the encryption key");
		}
		k_sem_give(&key_sem);

		return;
	}

	tail = recv[len - 1];

	if (is_hexchar(*recv)) {
		chunk[chunk_element] = *recv;
		chunk_element++;
	}

	if (chunk_element == 2) {
		byte = (uint8_t)strtoul(chunk, NULL, 16);
		master_key[sum] = byte;
		sum++;
		chunk_element = 0;
	}
}

static int cmd_key(const struct shell *sh, size_t argc, char **argv, void *data)
{
	ARG_UNUSED(argc);
	ARG_UNUSED(argv);
	ARG_UNUSED(data);

	shell_print(sh, "Please transmit the key through the serial. e.g: "
			"xxd -p key > /dev/ttyX\n"
			"Loading...\npress ctrl-x ctrl-q to escape");

	chunk_element = 0;
	sum = 0;

	shell_set_bypass(sh, bypass_cb);

	return 0;
}

static int cmd_utc(const struct shell *sh, size_t argc, char **argv, void *data)
{
	int ret = 0;
	static bool give_sem = true;

	ARG_UNUSED(sh);
	ARG_UNUSED(argc);
	ARG_UNUSED(data);

	utc_time = atoll(argv[1]);

	if (give_sem) {
		k_sem_give(&app_sem);
		give_sem = false;
	} else {
		ret = hubble_utc_set(utc_time);
	}

	return ret;
}

static int cmd_data(const struct shell *sh, size_t argc, char **argv, void *data)
{
	size_t out_len = HUBBLE_USER_BUFFER_LEN;
	int err = hubble_ble_advertise_get((const uint8_t *)argv[1],
					   strlen(argv[1]), _hubble_user_buffer,
					   &out_len);
	ARG_UNUSED(sh);
	ARG_UNUSED(argc);
	ARG_UNUSED(data);

	if (err != 0) {
		LOG_ERR("Failed to get the advertisement data (err=%d)", err);
		return err;
	}

	app_ad[1].data_len = out_len;
	app_ad[1].type = BT_DATA_SVC_DATA16;
	app_ad[1].data = _hubble_user_buffer;

	LOG_DBG("Updating advertisement data (len %d bytes)", out_len);

	return bt_le_adv_update_data(app_ad, ARRAY_SIZE(app_ad), NULL, 0);
}


SHELL_CMD_REGISTER(key, NULL, "Set Hubble Network key", cmd_key);
SHELL_CMD_ARG_REGISTER(utc, NULL, "Set UTC time", cmd_utc, 2, 0);
SHELL_CMD_ARG_REGISTER(data, NULL, "Set data to advertise", cmd_data, 2, 0);

int main(void)
{
	int err = 0;

	LOG_DBG("Hubble Network Sample %s", APP_VERSION_STRING);

	printk("Insert key and utc time to start. Type help for more "
	       "information.\n");

	/* Lets wait for the user to set UTC time and Key*/
	k_sem_take(&key_sem, K_FOREVER);
	k_sem_take(&app_sem, K_FOREVER);

	LOG_DBG("Key and UTC time set");

	err = hubble_init(utc_time, NULL);
	if (err != 0) {
		LOG_ERR("Failed to initialize Hubble BLE Network");
		return err;
	}

	/* Synchrounosly initialize the Bluetooth subsystem. */
	err = bt_enable(NULL);
	if (err != 0) {
		LOG_ERR("Bluetooth init failed (err %d)", err);
		return err;
	}

	err = bt_le_adv_start(BT_LE_ADV_PARAM(BT_LE_ADV_OPT_USE_NRPA,
					      BT_GAP_ADV_FAST_INT_MIN_2,
					      BT_GAP_ADV_FAST_INT_MAX_2, NULL),
			      NULL, 0, NULL, 0);
	if (err != 0) {
		LOG_ERR("Bluetooth advertisement failed (err %d)", err);
		goto end;
	}

	return 0;

end:
	(void)bt_disable();
	return err;
}
```
