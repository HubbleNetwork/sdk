## port/esp-idf/hubblenetwork-sdk/Kconfig
```kconfig
# Copyright (c) 2025 Hubble Network, Inc.
# SPDX-License-Identifier: Apache-2.0

config HUBBLE_EID_ROTATION_PERIOD_SEC
	int "EID rotation period in seconds"
	default 86400
	range 86400 86400
	help
	  EID rotation period. Currently only daily rotations
	  are supported (86400)

choice HUBBLE_COUNTER_SOURCE
	prompt "Counter source"
	default HUBBLE_COUNTER_SOURCE_UNIX_TIME

config HUBBLE_COUNTER_SOURCE_UNIX_TIME
	bool "Unix time counter source"
	help
	  Counter derived from Unix time. Requires time provisioning.

config HUBBLE_COUNTER_SOURCE_DEVICE_UPTIME
	bool "Device uptime counter source"
	help
	  Counter derived from device uptime. No Unix time required.
	  Initial counter value provided via hubble_init().

endchoice

menuconfig HUBBLE_SAT_NETWORK
	   bool "Hubble Satellite Network Library"
	   help
		Enable library for communication with Hubble network.

if HUBBLE_SAT_NETWORK

config HUBBLE_SAT_NETWORK_SMALL
	   bool "Use smaller code size for fly by calculation"
	   help
		Reduces code using polynomial approximation
		for trigonometric functions

config HUBBLE_SAT_NETWORK_DEVICE_TDR
	   int "Device time drift retry rate in PPM"
	   default 10
	   help
		Adds additional retries proportional to time since
		last time the device had time synced. It is
		represented in PPM (parts per million).

config HUBBLE_SAT_NETWORK_DTM_MODE
	bool "Enable DTM mode"
	help
	  Enable DTM mode in the SDK. It is intended
	  to test the operation of radio.

choice
	prompt "Hubble Sat Network protocol"
	default HUBBLE_SAT_NETWORK_PROTOCOL_V1

config HUBBLE_SAT_NETWORK_PROTOCOL_V1
	   bool "Use V1 protocol"
	   help
		First version of Sat protocol. Channel hopping within transmissions.
endchoice

endif

menuconfig HUBBLE_BLE_NETWORK
	   bool "Hubble BLE Network Library"
	   help
		Enable library for communication with Hubble BLE network

choice
	prompt "Hubble Network key size"

config HUBBLE_NETWORK_KEY_256
	   bool "Use 256 bits key size"
	   help
		256 bits key size

config HUBBLE_NETWORK_KEY_128
	   bool "Use 128 bits key size"
	   help
		128 bits key size

endchoice

config HUBBLE_KEY_SIZE
	   int
	   default 32 if HUBBLE_NETWORK_KEY_256
	   default 16 if HUBBLE_NETWORK_KEY_128

config HUBBLE_NETWORK_SECURITY_ENFORCE_NONCE_CHECK
	   bool "Enforce check in nonce used in cryptography"
	   default y
	   help
		Ensure that nonce parameters are not re-used
		to encrypt different messages.
		Be aware that re-using the same nonce has severe
		security implications.

config HUBBLE_NETWORK_SEQUENCE_NONCE_CUSTOM
	   bool "Application defined sequence counter"
	   help
		This option allows applications to override the default
		function that returns a sequence number to be used to
		encrypt messages.
```

## port/zephyr/Kconfig
```kconfig
# Copyright (c) 2024 Hubble Network, Inc.
# SPDX-License-Identifier: Apache-2.0

module = HUBBLE
module-str = HubbleNetwork
source "subsys/logging/Kconfig.template.log_config"

config HUBBLE_SAT_NETWORK
	bool "Hubble Satellite Network Library"
	select ENTROPY_GENERATOR
	help
	  Enable the satellite communication module.

if HUBBLE_SAT_NETWORK

config HUBBLE_SAT_NETWORK_SMALL
	bool "Use smaller code size for fly-by calculation"
	help
	  Use polynomial approximations for trigonometric functions
	  in satellite pass prediction code.

	  Reduces code size at the cost of reduced numerical
	  accuracy in pass window calculations. Suitable for
	  constrained devices where code size is critical.

config HUBBLE_SAT_NETWORK_DEVICE_TDR
	int "Device time drift retry rate in PPM"
	default 10
	help
	  Compensates for clock drift by adding retransmission
	  retries proportional to time elapsed since the last
	  time sync. Value is in parts per million (PPM).

	  Higher values add more retries for the same drift,
	  increasing reliability but also power consumption.
	  Default of 10 PPM is suitable for typical crystal
	  oscillators.

config HUBBLE_SAT_NETWORK_DTM_MODE
	bool "Enable DTM mode"
	help
	  Enable DTM mode in the SDK. It is intended
	  to test the operation of radio.

choice
	prompt "Hubble Sat Network protocol"
	default HUBBLE_SAT_NETWORK_PROTOCOL_V1
	help
	  Select the satellite communication protocol version.
	  The protocol determines packet framing and channel
	  hopping behavior during transmissions.

config HUBBLE_SAT_NETWORK_PROTOCOL_V1
	bool "Use V1 protocol"
	help
	  First version of the satellite protocol. Uses channel
	  hopping across 19 pre-computed channels within each
	  transmission window. Includes Reed-Solomon forward
	  error correction.

endchoice

endif

config HUBBLE_BLE_NETWORK
	bool "Hubble BLE Network Library"
	help
	  Enable the BLE advertisement module.

if HUBBLE_BLE_NETWORK || HUBBLE_SAT_NETWORK

choice
	prompt "Hubble Network key size"
	help
	  Select the master key size for AES encryption and CMAC
	  authentication. Sets the derived symbol
	  CONFIG_HUBBLE_KEY_SIZE used throughout the crypto layer
	  for buffer sizing and key operations.

config HUBBLE_NETWORK_KEY_256
	bool "Use 256 bits key size"
	help
	  Use AES-256 for encryption and CMAC operations.

config HUBBLE_NETWORK_KEY_128
	bool "Use 128 bits key size"
	help
	  Use AES-128 for encryption and CMAC operations.

endchoice

choice HUBBLE_COUNTER_SOURCE
	prompt "Counter source"
	default HUBBLE_COUNTER_SOURCE_UNIX_TIME
	help
	  Selects how the SDK computes the time counter used for
	  EID rotation and key derivation.

config HUBBLE_COUNTER_SOURCE_UNIX_TIME
	bool "Unix time counter source"
	help
	  Derive the time counter from Unix epoch time. The counter
	  increments once per rotation period
	  (CONFIG_HUBBLE_EID_ROTATION_PERIOD_SEC).

	  Best for devices with access to real-time clocks or
	  network time synchronization.

config HUBBLE_COUNTER_SOURCE_DEVICE_UPTIME
	bool "Device uptime counter source"
	help
	  Derive the time counter from device uptime. No Unix time
	  required.

	  Best for devices without a real-time clock, reliable
	  time source, or method to provision time.

endchoice

config HUBBLE_EID_ROTATION_PERIOD_SEC
	int "EID rotation period in seconds"
	default 86400
	range 86400 86400
	help
	  Period in seconds between EID (Ephemeral Identifier)
	  rotations. Each rotation derives new encryption keys
	  and a new BLE address for privacy.

	  Currently locked to 86400 (24 hours) for backend
	  compatibility. Future versions may support shorter
	  periods.

config HUBBLE_KEY_SIZE
	int
	default 32 if HUBBLE_NETWORK_KEY_256
	default 16 if HUBBLE_NETWORK_KEY_128

config HUBBLE_NETWORK_SECURITY_ENFORCE_NONCE_CHECK
	bool "Enforce check in nonce used in cryptography"
	default y
	help
	  Validates that the encryption nonce is unique before
	  encrypting. Prevents nonce reuse, which would compromise
	  AES-CTR confidentiality.

	  Enabled by default. Disabling removes the runtime check
	  but risks catastrophic security failure if nonces are
	  ever repeated. Only disable for testing or when the
	  application guarantees uniqueness by other means.

config HUBBLE_NETWORK_SEQUENCE_NONCE_CUSTOM
	bool "Application-defined sequence counter"
	help
	  Override the default auto-incrementing sequence counter
	  with an application-provided implementation. Useful for
	  deterministic testing or persisting counters across
	  reboots.

config HUBBLE_UPTIME_CUSTOM
	bool "Application-defined uptime implementation"
	help
	  Override the default platform uptime function with an
	  application-provided implementation. Primarily useful
	  for unit testing where controlled time values are
	  needed to verify time-dependent behavior.

choice
	prompt "Hubble Network crypto provider"
	default HUBBLE_NETWORK_CRYPTO_PSA
	help
	  Select the cryptographic backend for AES-CTR encryption
	  and CMAC authentication.

config HUBBLE_NETWORK_CRYPTO_MBEDTLS
	bool "Use MbedTLS"
	select MBEDTLS
	select MBEDTLS_CMAC
	select MBEDTLS_CIPHER
	select MBEDTLS_CIPHER_AES_ENABLED
	select MBEDTLS_CIPHER_MODE_CTR_ENABLED
	help
	  Use the MbedTLS library directly for AES-CTR and CMAC.

config HUBBLE_NETWORK_CRYPTO_PSA
	bool "Use PSA Crypto"
	select PSA_CRYPTO
	select PSA_WANT_KEY_TYPE_AES
	select PSA_WANT_ALG_CMAC
	select PSA_WANT_ALG_CTR
	select PSA_WANT_ALG_ECB_NO_PADDING
	help
	  Use the PSA Crypto API for AES-CTR and CMAC. This is
	  the recommended backend for Zephyr and nRF platforms.
	  When building with TF-M, cryptographic operations are
	  delegated to the secure processing environment.

config HUBBLE_NETWORK_CRYPTO_PSA_USE_KEY_ID
	bool "Use PSA Crypto opaque key id"
	depends on HUBBLE_NETWORK_CRYPTO_PSA
	help
	  Reference the Hubble key by its PSA opaque key
	  identifier instead of by its key material.

	  With this option the SDK never needs nor has access to
	  the Hubble key material. The application provisions the
	  key into a secure key storage (for example TF-M ITS or
	  a KMU) and hands the SDK only the key id returned by
	  that storage. All cryptographic operations are then
	  performed by the PSA implementation on the key it holds
	  internally, so the raw key never leaves the secure
	  storage.

config HUBBLE_NETWORK_CRYPTO_CUSTOM
	bool "Custom crypto implementation"
	help
	  Provide a custom cryptographic backend. The application
	  must implement all functions declared in
	  <hubble/port/crypto.h>

endchoice

endif

menu "Logging"

endmenu

rsource "Kconfig.nrf"
rsource "Kconfig.silabs"
```

## samples/esp-idf/sat-continuous/main/Kconfig.projbuild
```kconfig
# Copyright (c) 2026 Hubble Network, Inc.
# SPDX-License-Identifier: Apache-2.0

menu "Sat Continuous Sample Configuration"

    orsource "$IDF_PATH/examples/common_components/env_caps/$IDF_TARGET/Kconfig.env_caps"

    config HUBBLE_DEVICE_KEY
    string "Cryptography key in base64"
    default ""
    help
        Hubble device's cryptographic key

    config EXTERNAL_ANTENNA
    bool "Select XIAO ESP32-C6 External Antenna"
    default n
    help
        Select XIAO ESP32-C6 External Antenna - ufL

endmenu
```

## samples/esp-idf/sat-dual-stack/main/Kconfig.projbuild
```kconfig
# Copyright (c) 2026 Hubble Network, Inc.
# SPDX-License-Identifier: Apache-2.0

menu "Sat Dual Stack Sample Configuration"

    orsource "$IDF_PATH/examples/common_components/env_caps/$IDF_TARGET/Kconfig.env_caps"

    config HUBBLE_DEVICE_KEY
    string "Cryptography key in base64"
    default ""
    help
        Hubble device's cryptographic key

    config HUBBLE_SAMPLE_DEBUG
    bool "Enable debug mode"
    default n
    help
        Enable debug mode for the Hubble sample application.
        This will set the sat timer for 2 minutes instead
        of until a satellite pass is overhead.

    config EXTERNAL_ANTENNA
    bool "Select XIAO ESP32-C6 External Antenna"
    default n
    help
        Select XIAO ESP32-C6 External Antenna - ufL

endmenu
```

## samples/zephyr/sat-dtm/sample.yaml
```yaml
# Copyright (c) 2026 Hubble Network, Inc.
# SPDX-License-Identifier: Apache-2.0

sample:
  description: Hubble Network Satellite DTM example
  name: hubble-sat-dtm
common:
  build_only: true
  platform_allow:
    - nrf21540dk
    - xg24_rb4187c
  tags:
    - satellite
tests:
  app.sat.dtm.default: {}
```

## samples/zephyr/sat-dual-stack/sample.yaml
```yaml
# Copyright (c) 2026 Hubble Network, Inc.
# SPDX-License-Identifier: Apache-2.0

sample:
  description: Hubble Network dual-stack (BLE beacon + satellite) example
  name: hubble-sat-dual-stack
common:
  build_only: true
  depends_on:
    - ble
  tags:
    - bluetooth
    - satellite
  platform_allow:
    - native_sim
tests:
  app.sat.dual_stack.default:
      extra_configs:
      - CONFIG_SAMPLE_PROVIDE_SAT_BOARD_SUPPORT=y
  app.sat.dual_stack.debug:
    extra_configs:
      - CONFIG_HUBBLE_SAMPLE_DEBUG=y
      - CONFIG_SAMPLE_PROVIDE_SAT_BOARD_SUPPORT=y
  app.sat.dual_stack.128key:
    extra_configs:
      - CONFIG_HUBBLE_NETWORK_KEY_128=y
      - CONFIG_SAMPLE_PROVIDE_SAT_BOARD_SUPPORT=y
  app.sat.dual_stack.mbedtls:
    extra_configs:
      - CONFIG_HUBBLE_NETWORK_CRYPTO_MBEDTLS=y
      - CONFIG_SAMPLE_PROVIDE_SAT_BOARD_SUPPORT=y
  app.sat.dual_stack.mbedtls_128key:
    extra_configs:
      - CONFIG_HUBBLE_NETWORK_CRYPTO_MBEDTLS=y
      - CONFIG_HUBBLE_NETWORK_KEY_128=y
      - CONFIG_SAMPLE_PROVIDE_SAT_BOARD_SUPPORT=y
  app.sat.dual_stack.ncs:
    extra_configs:
      - CONFIG_SAMPLE_PROVIDE_SAT_BOARD_SUPPORT=n
    modules:
      - nrf
    tags:
      - ncs
    required_snippets:
      - ncs-dual-stack
    platform_exclude:
      - native_sim
    platform_allow:
      - nrf21540dk/nrf52840
    integration_platforms:
      - nrf21540dk/nrf52840
```
