## CMakeLists.txt
```
# Copyright (c) 2025 Hubble Network
# SPDX-License-Identifier: Apache-2.0

cmake_minimum_required(VERSION 3.20.0)
find_package(Zephyr REQUIRED HINTS $ENV{ZEPHYR_BASE})
project(ble_advertise_test)

FILE(GLOB app_sources src/*.c)
target_sources(app PRIVATE ${app_sources})
```

## prj.conf
```kconfig
CONFIG_ZTEST=y
CONFIG_ZTEST_STACK_SIZE=4096
CONFIG_MAIN_STACK_SIZE=4096

# Hubble BLE Network
CONFIG_HUBBLE_BLE_NETWORK=y
CONFIG_HUBBLE_BLE_NETWORK_TIMER_COUNTER_DAILY=y
CONFIG_HUBBLE_NETWORK_SEQUENCE_NONCE_CUSTOM=y
CONFIG_HUBBLE_UPTIME_CUSTOM=y

# Key size (match test vectors)
CONFIG_HUBBLE_NETWORK_KEY_256=y

# Disable nonce enforcement for testing arbitrary sequences
CONFIG_HUBBLE_NETWORK_SECURITY_ENFORCE_NONCE_CHECK=n
```

## src/main.c
```c
/*
 * Copyright (c) 2025 Hubble Network, Inc.
 *
 * SPDX-License-Identifier: Apache-2.0
 */

#include <hubble/hubble.h>
#include <hubble/ble.h>
#include <hubble/port/sys.h>
#include <hubble/port/crypto.h>

#include <zephyr/sys/util.h>
#include <zephyr/types.h>
#include <zephyr/ztest.h>

#include <string.h>

#include "test_vectors.h"

#define TEST_ADV_BUFFER_SZ      31
#define TIMER_COUNTER_FREQUENCY 86400000ULL

/* Test sequence counter override */
static uint16_t test_seq_override;

/* A arbitrarily chosen start time for the test */
static const uint64_t test_utc_time = (uint64_t)20 * TIMER_COUNTER_FREQUENCY;

/* Test uptime override */
static uint64_t test_uptime_ms;

uint16_t hubble_sequence_counter_get(void)
{
	return test_seq_override;
}

uint64_t hubble_uptime_get(void)
{
	return test_uptime_ms;
}

/* Test keys */
static const uint8_t test_key_primary[CONFIG_HUBBLE_KEY_SIZE] = {
	0xcd, 0x15, 0xa5, 0xab, 0xc0, 0x60, 0xb6, 0x72, 0x88, 0xa6, 0x1e,
	0x44, 0xe9, 0x95, 0xba, 0x77, 0xd1, 0x40, 0xbd, 0x46, 0x56, 0x4b,
	0x88, 0xde, 0x41, 0xc1, 0x5a, 0x92, 0x73, 0xb0, 0xce, 0x85};

/*===========================================================================*/
/* Test Suite: ble_advertise_test - Core Encryption Tests                   */
/*===========================================================================*/

ZTEST(ble_advertise_test, test_advertise_with_test_vectors)
{
	for (size_t i = 0; i < test_vectors_count; i++) {
		const struct ble_adv_test_vector *tv = &test_vectors[i];

		uint64_t utc_time =
			(uint64_t)tv->time_counter * TIMER_COUNTER_FREQUENCY;

		int ret = hubble_init(utc_time, test_key_primary);
		zassert_ok(ret, "hubble_init failed");
		test_seq_override = tv->seq_no;

		uint8_t output[TEST_ADV_BUFFER_SZ];
		size_t output_len = sizeof(output);

		ret = hubble_ble_advertise_get(tv->payload, tv->payload_len,
					       output, &output_len);

		zassert_ok(ret, "Vector %zu (%s) failed with error %d", i,
			   tv->description, ret);

		zassert_equal(
			output_len,
			tv->expected_len, "Vector %zu (%s) length mismatch: got %zu, expected %zu",
			i, tv->description, output_len, tv->expected_len);

		zassert_mem_equal(output, tv->expected, output_len,
				  "Vector %zu (%s) output mismatch", i,
				  tv->description);
	}
}

ZTEST(ble_advertise_test, test_advertise_null_input_handling)
{
	int ret = hubble_init(test_utc_time, test_key_primary);
	zassert_ok(ret, "hubble_init failed");
	test_seq_override = 0;

	uint8_t output[TEST_ADV_BUFFER_SZ];
	size_t output_len = sizeof(output);

	/* NULL input with zero length should succeed (empty payload is valid) */
	ret = hubble_ble_advertise_get(NULL, 0, output, &output_len);
	zassert_ok(ret, "NULL payload with length 0 should succeed");

	/* NULL output buffer should fail */
	ret = hubble_ble_advertise_get(NULL, 0, NULL, &output_len);
	zassert_equal(ret, -EINVAL, "NULL output buffer should return -EINVAL");

	/* NULL out_len should fail */
	ret = hubble_ble_advertise_get(NULL, 0, output, NULL);
	zassert_equal(ret, -EINVAL, "NULL out_len should return -EINVAL");

	/* NULL input payload with non-zero length should fail */
	output_len = sizeof(output);
	ret = hubble_ble_advertise_get(NULL, 5, output, &output_len);
	zassert_equal(
		ret, -EINVAL,
		"NULL payload with non-zero length should return -EINVAL");
}

ZTEST(ble_advertise_test, test_advertise_buffer_too_small)
{
	uint8_t payload[] = {0x01, 0x02, 0x03, 0x04, 0x05};

	int ret = hubble_init(test_utc_time, test_key_primary);
	zassert_ok(ret, "hubble_init failed");
	test_seq_override = 0;

	uint8_t output[8];
	size_t output_len = sizeof(output);

	/* Buffer too small for output */
	ret = hubble_ble_advertise_get(payload, sizeof(payload), output,
				       &output_len);
	zassert_equal(ret, -EINVAL, "Too small buffer should return -EINVAL");
}

ZTEST(ble_advertise_test, test_advertise_payload_size_limits)
{
	int ret = hubble_init(test_utc_time, test_key_primary);
	zassert_ok(ret, "hubble_init failed");
	test_seq_override = 0;

	uint8_t output[TEST_ADV_BUFFER_SZ];
	size_t output_len = sizeof(output);

	/* 13-byte payload should succeed (max = HUBBLE_BLE_MAX_DATA_LEN) */
	uint8_t max_payload[HUBBLE_BLE_MAX_DATA_LEN] = {0};
	ret = hubble_ble_advertise_get(max_payload, sizeof(max_payload), output,
				       &output_len);
	zassert_ok(ret, "Max payload (13 bytes) should succeed");

	/* 14-byte payload should fail */
	uint8_t too_large_payload[HUBBLE_BLE_MAX_DATA_LEN + 1] = {0};
	output_len = sizeof(output);
	ret = hubble_ble_advertise_get(too_large_payload,
				       sizeof(too_large_payload), output,
				       &output_len);
	zassert_equal(ret, -EINVAL, "Payload > 13 bytes should return -EINVAL");
}

ZTEST(ble_advertise_test, test_advertise_deterministic)
{
	uint8_t payload[] = {0x48, 0x65, 0x6c, 0x6c, 0x6f};

	int ret = hubble_init(test_utc_time, test_key_primary);
	zassert_ok(ret, "hubble_init failed");
	test_seq_override = 100;

	uint8_t output1[TEST_ADV_BUFFER_SZ];
	size_t output_len1 = sizeof(output1);

	ret = hubble_ble_advertise_get(payload, sizeof(payload), output1,
				       &output_len1);
	zassert_ok(ret);

	/* Call again with identical inputs */
	uint8_t output2[TEST_ADV_BUFFER_SZ];
	size_t output_len2 = sizeof(output2);

	ret = hubble_ble_advertise_get(payload, sizeof(payload), output2,
				       &output_len2);
	zassert_ok(ret);

	/* Verify both outputs are byte-identical */
	zassert_equal(output_len1, output_len2,
		      "Output lengths should be identical");
	zassert_mem_equal(output1, output2, output_len1,
			  "Outputs should be byte-identical (deterministic)");
}

ZTEST(ble_advertise_test, test_advertise_time_dependent_output)
{
	uint8_t payload[] = {0x48, 0x65, 0x6c, 0x6c, 0x6f};

	/* Initialize with uptime at 0 */
	test_uptime_ms = 0;
	int ret = hubble_init(test_utc_time, test_key_primary);
	zassert_ok(ret, "hubble_init failed");
	test_seq_override = 100;

	uint8_t output1[TEST_ADV_BUFFER_SZ];
	size_t output_len1 = sizeof(output1);

	ret = hubble_ble_advertise_get(payload, sizeof(payload), output1,
				       &output_len1);
	zassert_ok(ret, "First call failed");

	/* Advance time by one day (TIMER_COUNTER_FREQUENCY ms)
	 * This should change the time_counter and produce different output
	 */
	test_uptime_ms = TIMER_COUNTER_FREQUENCY;

	uint8_t output2[TEST_ADV_BUFFER_SZ];
	size_t output_len2 = sizeof(output2);

	ret = hubble_ble_advertise_get(payload, sizeof(payload), output2,
				       &output_len2);
	zassert_ok(ret, "Second call failed");

	/* Outputs should have the same length but different content
	 * due to different time_counter values
	 */
	zassert_equal(output_len1, output_len2, "Output lengths should match");
	zassert_true(memcmp(output1, output2, output_len1) != 0,
		     "Outputs should differ due to time progression");
}

ZTEST(ble_advertise_test, test_advertise_same_time_different_sequences)
{
	uint8_t payload[] = {0xAA, 0xBB};

	int ret = hubble_init(test_utc_time, test_key_primary);
	zassert_ok(ret, "hubble_init failed");

	/* Get output with sequence number 0 */
	test_seq_override = 0;

	uint8_t output1[TEST_ADV_BUFFER_SZ];
	size_t output_len1 = sizeof(output1);

	ret = hubble_ble_advertise_get(payload, sizeof(payload), output1,
				       &output_len1);
	zassert_ok(ret, "First call failed");

	/* Get output with sequence number 1, same time */
	test_seq_override = 1;

	uint8_t output2[TEST_ADV_BUFFER_SZ];
	size_t output_len2 = sizeof(output2);

	ret = hubble_ble_advertise_get(payload, sizeof(payload), output2,
				       &output_len2);
	zassert_ok(ret, "Second call failed");

	/* Outputs should differ due to different sequence numbers */
	zassert_equal(output_len1, output_len2, "Output lengths should match");
	zassert_true(memcmp(output1, output2, output_len1) != 0,
		     "Outputs should differ due to different sequence numbers");
}

static void *ble_advertise_test_setup(void)
{
	test_seq_override = 0;
	test_uptime_ms = 0;
	return NULL;
}

ZTEST_SUITE(ble_advertise_test, NULL, ble_advertise_test_setup, NULL, NULL, NULL);

/*===========================================================================*/
/* Test Suite: ble_advertise_format_test - Output Format Validation         */
/*===========================================================================*/

ZTEST(ble_advertise_format_test, test_service_uuid_present)
{
	uint8_t payload[] = {0xAA, 0xBB, 0xCC};

	int ret = hubble_init(test_utc_time, test_key_primary);
	zassert_ok(ret, "hubble_init failed");
	test_seq_override = 0;

	uint8_t output[TEST_ADV_BUFFER_SZ];
	size_t output_len = sizeof(output);

	ret = hubble_ble_advertise_get(payload, sizeof(payload), output,
				       &output_len);
	zassert_ok(ret);

	/* Service UUID should be first 2 bytes: 0xA6 0xFC (little-endian) */
	zassert_equal(output[0], 0xA6,
		      "First byte should be 0xA6 (UUID low byte)");
	zassert_equal(output[1], 0xFC,
		      "Second byte should be 0xFC (UUID high byte)");
}

ZTEST(ble_advertise_format_test, test_output_length_calculation)
{
	int ret = hubble_init(test_utc_time, test_key_primary);
	zassert_ok(ret, "hubble_init failed");

	/* Test different payload lengths */
	size_t test_payload_lens[] = {0, 1, 5, 13};

	/*
	 * Output length = 2 (UUID) + 2 (ver/seq) + 4 (tag) + 4 (EID)
	 * payload_len = 12 + payload_len
	 */
	const size_t HUBBLE_PAYLOAD_OVERHEAD = 12;

	for (size_t i = 0; i < ARRAY_SIZE(test_payload_lens); i++) {
		size_t payload_len = test_payload_lens[i];
		uint8_t payload[13] = {0};

		test_seq_override = (uint16_t)i;

		uint8_t output[TEST_ADV_BUFFER_SZ];
		size_t output_len = sizeof(output);

		ret = hubble_ble_advertise_get(payload, payload_len, output,
					       &output_len);
		zassert_ok(ret, "Failed for payload length %zu", payload_len);

		size_t expected_len = HUBBLE_PAYLOAD_OVERHEAD + payload_len;
		zassert_equal(
			output_len,
			expected_len, "Length mismatch for payload_len=%zu: got %zu, expected %zu",
			payload_len, output_len, expected_len);
	}
}

ZTEST(ble_advertise_format_test, test_sequence_number_encoding)
{
	int ret = hubble_init(test_utc_time, test_key_primary);
	zassert_ok(ret, "hubble_init failed");

	/* Test various sequence numbers */
	uint16_t test_seq_nos[] = {0, 1, 255, 256, 512, 1023};

	for (size_t i = 0; i < ARRAY_SIZE(test_seq_nos); i++) {
		test_seq_override = test_seq_nos[i];

		uint8_t output[TEST_ADV_BUFFER_SZ];
		size_t output_len = sizeof(output);

		ret = hubble_ble_advertise_get(NULL, 0, output, &output_len);
		zassert_ok(ret);

		/*
		 * Parse sequence number from address field:
		 * Byte 2-3 contain protocol_version (6 bits) + seq_no (10 bits)
		 * Skip first 2 bytes (UUID), then parse bits
		 */
		uint16_t parsed_seq_no = ((output[2] & 0x03) << 8) | output[3];

		zassert_equal(parsed_seq_no, test_seq_nos[i],
			      "Seq_no mismatch: got %u, expected %u",
			      parsed_seq_no, test_seq_nos[i]);
	}
}

static void *ble_advertise_format_test_setup(void)
{
	test_seq_override = 0;
	test_uptime_ms = 0;
	return NULL;
}

ZTEST_SUITE(ble_advertise_format_test, NULL, ble_advertise_format_test_setup,
	    NULL, NULL, NULL);
```

## src/test_vectors.c
```c
/*
 * Copyright (c) 2026 Hubble Network, Inc.
 * SPDX-License-Identifier: Apache-2.0
 *
 * Master key: cd:15:a5:ab:c0:60:b6:72:88:a6:1e:44:e9:95:ba:77:
 *             d1:40:bd:46:56:4b:88:de:41:c1:5a:92:73:b0:ce:85
 */

#include "test_vectors.h"

/* Test Vector 1: Empty payload */
static const uint8_t tv1_payload[] = {};

static const uint8_t tv1_expected[] = {0xa6, 0xfc, 0x00, 0x00, 0x60, 0xdb,
				       0x85, 0x95, 0x8f, 0xd7, 0x43, 0x9c};

/* Test Vector 2: Single byte */
static const uint8_t tv2_payload[] = {0xaa};

static const uint8_t tv2_expected[] = {0xa6, 0xfc, 0x00, 0x01, 0x60, 0xdb, 0x85,
				       0x95, 0xd2, 0x1b, 0xb5, 0x71, 0x82};

/* Test Vector 3: Hello world */
static const uint8_t tv3_payload[] = {0x48, 0x65, 0x6c, 0x6c, 0x6f};

static const uint8_t tv3_expected[] = {0xa6, 0xfc, 0x00, 0x64, 0x60, 0xdb,
				       0x85, 0x95, 0xa2, 0xa4, 0xc7, 0x70,
				       0x8a, 0x6d, 0xc7, 0x2a, 0x6b};

/* Test Vector 4: Binary pattern */
static const uint8_t tv4_payload[] = {0xde, 0xad, 0xbe, 0xef};

static const uint8_t tv4_expected[] = {0xa6, 0xfc, 0x00, 0xff, 0x60, 0xdb,
				       0x85, 0x95, 0x75, 0xe6, 0x93, 0xea,
				       0x75, 0x6f, 0x58, 0x7d};

/* Test Vector 5: All zeros */
static const uint8_t tv5_payload[] = {0x00, 0x00, 0x00, 0x00,
				      0x00, 0x00, 0x00, 0x00};

static const uint8_t tv5_expected[] = {0xa6, 0xfc, 0x01, 0x00, 0x60, 0xdb, 0x85,
				       0x95, 0xff, 0x87, 0x32, 0xc0, 0x65, 0x0e,
				       0x09, 0x37, 0x25, 0x84, 0x70, 0x61};

/* Test Vector 6: All ones */
static const uint8_t tv6_payload[] = {0xff, 0xff, 0xff, 0xff,
				      0xff, 0xff, 0xff, 0xff};

static const uint8_t tv6_expected[] = {0xa6, 0xfc, 0x02, 0x00, 0x60, 0xdb, 0x85,
				       0x95, 0x8b, 0x85, 0x45, 0x1e, 0x22, 0x66,
				       0x39, 0xc4, 0x3f, 0x4a, 0x7c, 0x5f};

/* Test Vector 7: Max length ASCII */
static const uint8_t tv7_payload[] = {0x48, 0x65, 0x6c, 0x6c, 0x6f, 0x20, 0x57,
				      0x6f, 0x72, 0x6c, 0x64, 0x21, 0x21};

static const uint8_t tv7_expected[] = {0xa6, 0xfc, 0x03, 0xff, 0x60, 0xdb, 0x85,
				       0x95, 0x8b, 0x21, 0x17, 0x2f, 0xb4, 0xb9,
				       0x85, 0x35, 0x9a, 0xe4, 0xce, 0x1a, 0xa0,
				       0x8b, 0xe5, 0xe3, 0x73};

/* Test Vector 8: Max length binary */
static const uint8_t tv8_payload[] = {0x00, 0x01, 0x02, 0x03, 0x04, 0x05, 0x06,
				      0x07, 0x08, 0x09, 0x0a, 0x0b, 0x0c};

static const uint8_t tv8_expected[] = {0xa6, 0xfc, 0x00, 0x00, 0xc9, 0xf3, 0x09,
				       0xbc, 0x4b, 0xeb, 0x66, 0xb6, 0xef, 0xf3,
				       0x09, 0x0d, 0xdc, 0x7b, 0x38, 0x94, 0x93,
				       0xf8, 0x40, 0x53, 0x28};

/* Test Vector 9: Mid-length */
static const uint8_t tv9_payload[] = {0x54, 0x65, 0x73, 0x74, 0x31, 0x32, 0x33};

static const uint8_t tv9_expected[] = {0xa6, 0xfc, 0x01, 0xf4, 0xa1, 0x08, 0x77,
				       0x49, 0x39, 0x8c, 0x87, 0x9d, 0x3e, 0xed,
				       0xb3, 0x9f, 0xb4, 0xdc, 0x79};

/* Test Vector 10: Numeric sequence */
static const uint8_t tv10_payload[] = {0x01, 0x02, 0x03, 0x04, 0x05,
				       0x06, 0x07, 0x08, 0x09, 0x0a};

static const uint8_t tv10_expected[] = {
	0xa6, 0xfc, 0x00, 0x2a, 0xd6, 0x1e, 0xa0, 0x75, 0xb2, 0x34, 0x5b,
	0xf5, 0x5f, 0xb7, 0x38, 0x5d, 0xe0, 0x56, 0x94, 0xce, 0x4f, 0x35};

const struct ble_adv_test_vector test_vectors[] = {
	{.description = "Empty payload",
	 .time_counter = 20,
	 .seq_no = 0,
	 .payload = tv1_payload,
	 .payload_len = 0,
	 .expected = tv1_expected,
	 .expected_len = sizeof(tv1_expected)},
	{.description = "Single byte",
	 .time_counter = 20,
	 .seq_no = 1,
	 .payload = tv2_payload,
	 .payload_len = sizeof(tv2_payload),
	 .expected = tv2_expected,
	 .expected_len = sizeof(tv2_expected)},
	{.description = "Hello world",
	 .time_counter = 20,
	 .seq_no = 100,
	 .payload = tv3_payload,
	 .payload_len = sizeof(tv3_payload),
	 .expected = tv3_expected,
	 .expected_len = sizeof(tv3_expected)},
	{.description = "Binary pattern",
	 .time_counter = 20,
	 .seq_no = 255,
	 .payload = tv4_payload,
	 .payload_len = sizeof(tv4_payload),
	 .expected = tv4_expected,
	 .expected_len = sizeof(tv4_expected)},
	{.description = "All zeros",
	 .time_counter = 20,
	 .seq_no = 256,
	 .payload = tv5_payload,
	 .payload_len = sizeof(tv5_payload),
	 .expected = tv5_expected,
	 .expected_len = sizeof(tv5_expected)},
	{.description = "All ones",
	 .time_counter = 20,
	 .seq_no = 512,
	 .payload = tv6_payload,
	 .payload_len = sizeof(tv6_payload),
	 .expected = tv6_expected,
	 .expected_len = sizeof(tv6_expected)},
	{.description = "Max length ASCII",
	 .time_counter = 20,
	 .seq_no = 1023,
	 .payload = tv7_payload,
	 .payload_len = sizeof(tv7_payload),
	 .expected = tv7_expected,
	 .expected_len = sizeof(tv7_expected)},
	{.description = "Max length binary",
	 .time_counter = 1,
	 .seq_no = 0,
	 .payload = tv8_payload,
	 .payload_len = sizeof(tv8_payload),
	 .expected = tv8_expected,
	 .expected_len = sizeof(tv8_expected)},
	{.description = "Mid-length",
	 .time_counter = 1000,
	 .seq_no = 500,
	 .payload = tv9_payload,
	 .payload_len = sizeof(tv9_payload),
	 .expected = tv9_expected,
	 .expected_len = sizeof(tv9_expected)},
	{.description = "Numeric sequence",
	 .time_counter = 5000,
	 .seq_no = 42,
	 .payload = tv10_payload,
	 .payload_len = sizeof(tv10_payload),
	 .expected = tv10_expected,
	 .expected_len = sizeof(tv10_expected)},
};

const size_t test_vectors_count = sizeof(test_vectors) / sizeof(test_vectors[0]);
```

## src/test_vectors.h
```c
/*
 * Copyright (c) 2026 Hubble Network, Inc.
 * SPDX-License-Identifier: Apache-2.0
 */

#ifndef TEST_VECTORS_H
#define TEST_VECTORS_H

#include <stddef.h>
#include <stdint.h>

/**
 * @brief Test vector for BLE advertisement encryption
 */
struct ble_adv_test_vector {
	const char *description; /* Human-readable test case name */
	uint32_t time_counter;   /* Time counter value */
	uint16_t seq_no;         /* Sequence number */
	const uint8_t *payload;  /* Cleartext payload input */
	size_t payload_len;      /* Payload length (0-13) */
	const uint8_t *expected; /* Expected BLE advertisement output */
	size_t expected_len;     /* Expected output length */
};

/* Test vectors generated by tools/ble-adv-vectors.py */
extern const struct ble_adv_test_vector test_vectors[];
extern const size_t test_vectors_count;

#endif /* TEST_VECTORS_H */
```
