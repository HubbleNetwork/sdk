## CMakeLists.txt
```
# Copyright (c) 2026 Hubble Network, Inc.
# SPDX-License-Identifier: Apache-2.0

cmake_minimum_required(VERSION 3.20.0)
find_package(Zephyr REQUIRED HINTS $ENV{ZEPHYR_BASE})
project(sat_packet_test)

FILE(GLOB app_sources src/*.c)
target_sources(app PRIVATE ${app_sources})
```

## prj.conf
```kconfig
CONFIG_ZTEST=y
CONFIG_ZTEST_STACK_SIZE=4096
CONFIG_MAIN_STACK_SIZE=4096

# Hubble Satellite Network
CONFIG_HUBBLE_SAT_NETWORK=y

# Pin the counter and the sequence number so packets are reproducible
CONFIG_HUBBLE_COUNTER_SOURCE_UNIX_TIME=y
CONFIG_HUBBLE_EID_ROTATION_PERIOD_SEC=86400
CONFIG_HUBBLE_NETWORK_SEQUENCE_NONCE_CUSTOM=y
CONFIG_HUBBLE_UPTIME_CUSTOM=y

# Key size (match test vectors)
CONFIG_HUBBLE_NETWORK_KEY_256=y

# The tests replay fixed sequence numbers on purpose
CONFIG_HUBBLE_NETWORK_SECURITY_ENFORCE_NONCE_CHECK=n
```

## src/main.c
```c
/*
 * Copyright (c) 2026 Hubble Network, Inc.
 *
 * SPDX-License-Identifier: Apache-2.0
 */

/*
 * Unit tests for hubble_sat_packet_get().
 *
 */

#include <hubble/hubble.h>
#include <hubble/sat.h>
#include <hubble/sat/packet.h>
#include <hubble/port/sys.h>
#include <hubble/port/crypto.h>

#include <zephyr/sys/util.h>
#include <zephyr/ztest.h>

#include <string.h>

#include "test_vectors.h"

#define ROTATION_PERIOD_MS 86400000ULL

/* Sequence counter override (CONFIG_HUBBLE_NETWORK_SEQUENCE_NONCE_CUSTOM). */
static uint16_t test_seq_override;

uint16_t hubble_sequence_counter_get(void)
{
	return test_seq_override;
}

/* Pin uptime to 0 so hubble_time_get() returns exactly what we passed in. */
uint64_t hubble_uptime_get(void)
{
	return 0;
}

int hubble_sat_board_init(void)
{
	return 0;
}

int hubble_sat_board_enable(void)
{
	return 0;
}

int hubble_sat_board_disable(void)
{
	return 0;
}

int hubble_sat_board_packet_send(const struct hubble_sat_packet_frames *packet)
{
	ARG_UNUSED(packet);

	return 0;
}

/* Payload length -> (payload symbols, ECC symbols), per the protocol tables in
 * src/hubble_sat_packet.c. packet->length must be their sum.
 */
static const struct {
	size_t payload_len;
	size_t symbols;
	size_t ecc;
} length_table[] = {
	{0, 13, 10},
	{4, 18, 12},
	{9, 25, 14},
	{13, 30, 16},
};

static int packet_get(struct hubble_sat_packet *packet, uint32_t time_counter,
		      uint16_t seq_no, const uint8_t *payload, size_t len)
{
	int ret = hubble_init((uint64_t)time_counter * ROTATION_PERIOD_MS,
			      test_key);

	zassert_ok(ret, "hubble_init failed: %d", ret);
	test_seq_override = seq_no;

	memset(packet, 0, sizeof(*packet));

	return hubble_sat_packet_get(packet, payload, len);
}

/*
 * Primary regression test: the full packet must match byte-for-byte.
 */
ZTEST(sat_packet_test, test_packet_known_answer)
{
	for (size_t i = 0; i < test_vectors_count; i++) {
		const struct sat_packet_test_vector *tv = &test_vectors[i];
		struct hubble_sat_packet packet;

		int ret = packet_get(&packet, tv->time_counter, tv->seq_no,
				     tv->payload, tv->payload_len);

		zassert_ok(ret, "Vector %zu (%s) failed with error %d", i,
			   tv->description, ret);

		zassert_equal(packet.length, tv->expected_len,
			      "Vector %zu (%s) length mismatch: got %zu, "
			      "expected %zu",
			      i, tv->description, packet.length,
			      tv->expected_len);

		zassert_mem_equal(packet.data, tv->expected, tv->expected_len,
				  "Vector %zu (%s) packet mismatch", i,
				  tv->description);
	}
}

/*
 * The parity block must land at the end of the systematic data, not at
 * symbols[ecc]. When it does not, the symbols past 2*ecc are never written and
 * stay zero for every input — so they cannot vary with the sequence number.
 *
 * This catches the same defect as the known-answer test without depending on
 * the golden data, so it keeps holding if the vectors are ever regenerated.
 */
ZTEST(sat_packet_test, test_packet_tail_is_populated)
{
	for (size_t i = 0; i < ARRAY_SIZE(length_table); i++) {
		size_t len = length_table[i].payload_len;
		size_t tail = 2U * length_table[i].ecc;
		struct hubble_sat_packet first, second;
		int ret;

		zassert_true(
			tail < length_table[i].symbols + length_table[i].ecc,
			"test bug: no tail region for payload_len=%zu", len);

		ret = packet_get(&first, 20000U, 1U, test_payload, len);
		zassert_ok(ret, "payload_len=%zu failed: %d", len, ret);

		ret = packet_get(&second, 20000U, 2U, test_payload, len);
		zassert_ok(ret, "payload_len=%zu failed: %d", len, ret);

		zassert_true(
			memcmp(&first.data[tail], &second.data[tail],
			       first.length - tail) != 0,
			"payload_len=%zu: symbols [%zu..%zu) are identical "
			"for two different sequence numbers - the parity "
			"block was written at the wrong offset and the "
			"packet tail was never populated",
			len, tail, first.length);
	}
}

/*
 * packet->length must be payload symbols + ECC symbols for every supported
 * payload size. A parity block written at the wrong offset does not change
 * this, so it is a companion check rather than a regression test on its own.
 */
ZTEST(sat_packet_test, test_packet_length_table)
{
	for (size_t i = 0; i < ARRAY_SIZE(length_table); i++) {
		struct hubble_sat_packet packet;
		size_t expected = length_table[i].symbols + length_table[i].ecc;

		int ret = packet_get(&packet, 20000U, 0U, test_payload,
				     length_table[i].payload_len);

		zassert_ok(ret, "payload_len=%zu failed: %d",
			   length_table[i].payload_len, ret);
		zassert_equal(packet.length, expected,
			      "payload_len=%zu: got length %zu, expected %zu",
			      length_table[i].payload_len, packet.length,
			      expected);
		zassert_true(packet.length <= HUBBLE_PACKET_MAX_SIZE,
			     "payload_len=%zu: length %zu exceeds "
			     "HUBBLE_PACKET_MAX_SIZE",
			     length_table[i].payload_len, packet.length);
	}
}

/*
 * Only 0, 4, 9 and 13 byte payloads are supported. Both of the switches that
 * map a payload length (size and ECC) must reject everything else; letting an
 * unsupported length through is what f329e45 originally set out to fix.
 */
ZTEST(sat_packet_test, test_packet_invalid_length)
{
	for (size_t len = 1; len <= 14; len++) {
		struct hubble_sat_packet packet;
		int ret;

		if ((len == 4U) || (len == 9U) || (len == 13U)) {
			continue;
		}

		ret = packet_get(&packet, 20000U, 0U, test_payload, len);
		zassert_equal(ret, -EINVAL,
			      "payload_len=%zu should be rejected, got %d", len,
			      ret);
	}
}

ZTEST(sat_packet_test, test_packet_null_args)
{
	struct hubble_sat_packet packet;
	int ret = hubble_init(0xdeadbeef, test_key);

	zassert_ok(ret, "hubble_init failed: %d", ret);
	test_seq_override = 0;

	zassert_equal(hubble_sat_packet_get(NULL, test_payload, 4), -EINVAL,
		      "NULL packet should return -EINVAL");
	zassert_equal(
		hubble_sat_packet_get(&packet, NULL, 4), -EINVAL,
		"NULL payload with non-zero length should return -EINVAL");
	zassert_ok(hubble_sat_packet_get(&packet, NULL, 0),
		   "NULL payload with length 0 should succeed");
}

static void *sat_packet_test_setup(void)
{
	test_seq_override = 0;

	return NULL;
}

ZTEST_SUITE(sat_packet_test, NULL, sat_packet_test_setup, NULL, NULL, NULL);
```

## src/test_vectors.c
```c
/*
 * Copyright (c) 2026 Hubble Network, Inc.
 * SPDX-License-Identifier: Apache-2.0
 */

/*
 * Known-answer vectors for hubble_sat_packet_get().
 *
 * These packets were generated in unix-time counter mode with a 86400 s rotation
 * period, which is what tests/zephyr/unit/sat-packet/prj.conf configures.
 */

#include "test_vectors.h"

const uint8_t test_payload[13] = {0x00, 0x01, 0x02, 0x03, 0x04, 0x05, 0x06,
				  0x07, 0x08, 0x09, 0x0a, 0x0b, 0x0c};

/* Same key as the BLE advertise unit test, for consistency. */
const uint8_t test_key[32] = {0xcd, 0x15, 0xa5, 0xab, 0xc0, 0x60, 0xb6, 0x72,
			      0x88, 0xa6, 0x1e, 0x44, 0xe9, 0x95, 0xba, 0x77,
			      0xd1, 0x40, 0xbd, 0x46, 0x56, 0x4b, 0x88, 0xde,
			      0x41, 0xc1, 0x5a, 0x92, 0x73, 0xb0, 0xce, 0x85};

const struct sat_packet_test_vector test_vectors[] = {
	{
		.description = "payload_len=0",
		.time_counter = 20000U,
		.seq_no = 0U,
		.payload = test_payload,
		.payload_len = 0,
		.expected_len = 23,
		.expected =
			{
				0x00, 0x00, 0x31, 0x3c, 0x1a, 0x1c, 0x0c, 0x06,
				0x2a, 0x08, 0x20, 0x0c, 0x24, 0x00, 0x33, 0x16,
				0x0a, 0x17, 0x3f, 0x36, 0x0f, 0x08, 0x3a,
			},
	},
	{
		.description = "payload_len=4",
		.time_counter = 20000U,
		.seq_no = 1U,
		.payload = test_payload,
		.payload_len = 4,
		.expected_len = 30,
		.expected =
			{
				0x00, 0x01, 0x31, 0x3c, 0x1a, 0x1c, 0x0c, 0x06,
				0x3c, 0x2f, 0x04, 0x32, 0x35, 0x0f, 0x20, 0x17,
				0x16, 0x02, 0x34, 0x08, 0x11, 0x03, 0x05, 0x25,
				0x24, 0x2a, 0x2a, 0x13, 0x1b, 0x05,
			},
	},
	{
		.description = "payload_len=9",
		.time_counter = 20001U,
		.seq_no = 512U,
		.payload = test_payload,
		.payload_len = 9,
		.expected_len = 39,
		.expected =
			{
				0x08, 0x00, 0x03, 0x19, 0x0a, 0x03, 0x25, 0x2c,
				0x2f, 0x04, 0x24, 0x00, 0x22, 0x04, 0x28, 0x23,
				0x35, 0x2b, 0x1f, 0x0e, 0x07, 0x16, 0x16, 0x08,
				0x20, 0x19, 0x05, 0x1b, 0x01, 0x2f, 0x19, 0x2f,
				0x14, 0x36, 0x30, 0x0b, 0x26, 0x3e, 0x26,
			},
	},
	{
		.description = "payload_len=13",
		.time_counter = 20001U,
		.seq_no = 1023U,
		.payload = test_payload,
		.payload_len = 13,
		.expected_len = 46,
		.expected =
			{
				0x0f, 0x3f, 0x03, 0x19, 0x0a, 0x03, 0x25, 0x29,
				0x10, 0x27, 0x09, 0x3c, 0x39, 0x20, 0x16, 0x22,
				0x19, 0x19, 0x36, 0x3b, 0x18, 0x2f, 0x23, 0x3e,
				0x22, 0x1e, 0x18, 0x0c, 0x3b, 0x0f, 0x0f, 0x15,
				0x36, 0x19, 0x22, 0x12, 0x16, 0x08, 0x03, 0x22,
				0x3c, 0x1f, 0x2c, 0x27, 0x0e, 0x13,
			},
	},
};

const size_t test_vectors_count = sizeof(test_vectors) / sizeof(test_vectors[0]);
```

## src/test_vectors.h
```c
/*
 * Copyright (c) 2026 Hubble Network, Inc.
 * SPDX-License-Identifier: Apache-2.0
 */

#ifndef TEST_VECTORS_H
#define TEST_VECTORS_H

#include <stddef.h>
#include <stdint.h>

#include <hubble/sat/packet.h>

/**
 * @brief Known-answer test vector for satellite packet construction.
 */
struct sat_packet_test_vector {
	const char *description; /* Human-readable test case name */
	uint32_t time_counter;   /* Time counter value */
	uint16_t seq_no;         /* Sequence number */
	const uint8_t *payload;  /* Cleartext payload input */
	size_t payload_len;      /* Payload length (0, 4, 9 or 13) */
	size_t expected_len;     /* Expected packet->length, in symbols */
	uint8_t expected[HUBBLE_PACKET_MAX_SIZE]; /* Expected packet->data */
};

/* Cleartext payload; the shorter cases use a prefix of this buffer. */
extern const uint8_t test_payload[13];

/* Master key the vectors were generated with. */
extern const uint8_t test_key[32];

extern const struct sat_packet_test_vector test_vectors[];
extern const size_t test_vectors_count;

#endif /* TEST_VECTORS_H */
```
