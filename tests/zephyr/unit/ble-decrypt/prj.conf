## CMakeLists.txt
```
# Copyright (c) 2025 Hubble Network
#
# SPDX-License-Identifier: Apache-2.0

cmake_minimum_required(VERSION 3.20.0)
find_package(Zephyr REQUIRED HINTS $ENV{ZEPHYR_BASE})
project(ble_decrypt_test)

FILE(GLOB app_sources src/*.c)
target_sources(app PRIVATE ${app_sources})
```

## prj.conf
```kconfig
CONFIG_ZTEST=y
CONFIG_ZTEST_STACK_SIZE=4096
CONFIG_MAIN_STACK_SIZE=4096

# Hubble BLE Network (no CONFIG_BT needed for native_sim crypto tests)
CONFIG_HUBBLE_BLE_NETWORK=y
CONFIG_HUBBLE_BLE_NETWORK_TIMER_COUNTER_DAILY=y
CONFIG_HUBBLE_NETWORK_SEQUENCE_NONCE_CUSTOM=y

# Key size (match production)
CONFIG_HUBBLE_NETWORK_KEY_256=y

# Disable nonce enforcement for testing different sequences
CONFIG_HUBBLE_NETWORK_SECURITY_ENFORCE_NONCE_CHECK=n
```

## src/main.c
```c
/*
 * Copyright (c) 2025 Hubble Network, Inc.
 *
 * SPDX-License-Identifier: Apache-2.0
 */

#include <hubble/hubble.h>
#include <hubble/port/sys.h>
#include <hubble/port/crypto.h>

#include <zephyr/sys/util.h>
#include <zephyr/types.h>
#include <zephyr/ztest.h>

#include "test_decrypt.h"

#define TEST_ADV_BUFFER_SZ      32
#define TIMER_COUNTER_FREQUENCY 86400000ULL

/* Test sequence counter override */
static uint16_t test_seq_override;

uint16_t hubble_sequence_counter_get(void)
{
	return test_seq_override;
}

/* Test keys */
static const uint8_t test_key_primary[CONFIG_HUBBLE_KEY_SIZE] = {
	0xcd, 0x15, 0xa5, 0xab, 0xc0, 0x60, 0xb6, 0x72, 0x88, 0xa6, 0x1e,
	0x44, 0xe9, 0x95, 0xba, 0x77, 0xd1, 0x40, 0xbd, 0x46, 0x56, 0x4b,
	0x88, 0xde, 0x41, 0xc1, 0x5a, 0x92, 0x73, 0xb0, 0xce, 0x85};

static const uint8_t test_key_zeros[CONFIG_HUBBLE_KEY_SIZE] = {0};

/*===========================================================================*/
/* Test Suite: ble_decrypt_test - Round-trip encryption/decryption           */
/*===========================================================================*/

ZTEST(ble_decrypt_test, test_roundtrip_empty_payload)
{
	uint32_t time_counter = 20;
	uint64_t utc_time = (uint64_t)time_counter * TIMER_COUNTER_FREQUENCY;

	hubble_init(utc_time, test_key_primary);
	test_seq_override = 0;

	uint8_t output[TEST_ADV_BUFFER_SZ];
	size_t output_len = sizeof(output);

	int ret = hubble_ble_advertise_get(NULL, 0, output, &output_len);
	zassert_ok(ret);

	/* Parse the advertisement */
	struct test_ble_adv_parsed parsed;
	ret = test_parse_ble_adv(output, output_len, &parsed);
	zassert_ok(ret);

	/* Verify sequence number in output */
	zassert_equal(parsed.seq_no, 0);

	/* Verify encrypted length is 0 */
	zassert_equal(parsed.encrypted_len, 0);

	/* Verify auth tag (CMAC of empty data) */
	ret = test_verify_auth_tag(test_key_primary, time_counter, 0,
				   parsed.encrypted_data, 0, parsed.auth_tag);
	zassert_ok(ret, "Auth tag verification failed");
}

ZTEST(ble_decrypt_test, test_roundtrip_max_payload)
{
	uint32_t time_counter = 20;
	uint64_t utc_time = (uint64_t)time_counter * TIMER_COUNTER_FREQUENCY;
	uint8_t payload[HUBBLE_BLE_MAX_DATA_LEN];

	/* Fill with recognizable pattern */
	for (size_t i = 0; i < sizeof(payload); i++) {
		payload[i] = (uint8_t)(i * 17 + 3);
	}

	hubble_init(utc_time, test_key_primary);
	test_seq_override = 100;

	uint8_t output[TEST_ADV_BUFFER_SZ];
	size_t output_len = sizeof(output);

	int ret = hubble_ble_advertise_get(payload, sizeof(payload), output,
					   &output_len);
	zassert_ok(ret);

	/* Parse and decrypt */
	struct test_ble_adv_parsed parsed;
	ret = test_parse_ble_adv(output, output_len, &parsed);
	zassert_ok(ret);

	zassert_equal(parsed.encrypted_len, sizeof(payload));

	uint8_t decrypted[HUBBLE_BLE_MAX_DATA_LEN];
	ret = test_decrypt_payload(test_key_primary, time_counter,
				   test_seq_override, parsed.encrypted_data,
				   parsed.encrypted_len, decrypted);
	zassert_ok(ret);

	/* Verify decrypted matches original */
	zassert_mem_equal(decrypted, payload, sizeof(payload),
			  "Decrypted data does not match original");

	/* Verify auth tag */
	ret = test_verify_auth_tag(test_key_primary, time_counter,
				   test_seq_override, parsed.encrypted_data,
				   parsed.encrypted_len, parsed.auth_tag);
	zassert_ok(ret, "Auth tag verification failed");
}

ZTEST(ble_decrypt_test, test_roundtrip_various_payloads)
{
	uint32_t time_counter = 1;
	uint64_t utc_time = (uint64_t)time_counter * TIMER_COUNTER_FREQUENCY;

	static const uint8_t test_payloads[][13] = {
		{0xDE, 0xAD, 0xBE, 0xEF},
		{0x00},
		{0xFF},
		{0x01, 0x02, 0x03, 0x04, 0x05},
		{'H', 'e', 'l', 'l', 'o'},
	};
	static const size_t test_payload_lens[] = {4, 1, 1, 5, 5};

	hubble_init(utc_time, test_key_primary);

	for (size_t i = 0; i < ARRAY_SIZE(test_payloads); i++) {
		test_seq_override = (uint16_t)(i * 50);

		uint8_t output[TEST_ADV_BUFFER_SZ];
		size_t output_len = sizeof(output);

		int ret = hubble_ble_advertise_get(test_payloads[i],
						   test_payload_lens[i], output,
						   &output_len);
		zassert_ok(ret, "Failed for payload %zu", i);

		struct test_ble_adv_parsed parsed;
		ret = test_parse_ble_adv(output, output_len, &parsed);
		zassert_ok(ret);

		uint8_t decrypted[HUBBLE_BLE_MAX_DATA_LEN];
		ret = test_decrypt_payload(
			test_key_primary, time_counter, test_seq_override,
			parsed.encrypted_data, parsed.encrypted_len, decrypted);
		zassert_ok(ret);

		zassert_mem_equal(decrypted, test_payloads[i],
				  test_payload_lens[i],
				  "Roundtrip failed for payload %zu", i);
	}
}

ZTEST(ble_decrypt_test, test_auth_tag_validates)
{
	uint32_t time_counter = 20;
	uint64_t utc_time = (uint64_t)time_counter * TIMER_COUNTER_FREQUENCY;
	uint8_t payload[] = {0xDE, 0xAD, 0xBE, 0xEF};

	hubble_init(utc_time, test_key_primary);
	test_seq_override = 42;

	uint8_t output[TEST_ADV_BUFFER_SZ];
	size_t output_len = sizeof(output);

	int ret = hubble_ble_advertise_get(payload, sizeof(payload), output,
					   &output_len);
	zassert_ok(ret);

	struct test_ble_adv_parsed parsed;
	ret = test_parse_ble_adv(output, output_len, &parsed);
	zassert_ok(ret);

	/* Auth tag should validate */
	ret = test_verify_auth_tag(test_key_primary, time_counter,
				   test_seq_override, parsed.encrypted_data,
				   parsed.encrypted_len, parsed.auth_tag);
	zassert_ok(ret, "Valid auth tag should verify successfully");
}

ZTEST(ble_decrypt_test, test_tampered_data_fails)
{
	uint32_t time_counter = 20;
	uint64_t utc_time = (uint64_t)time_counter * TIMER_COUNTER_FREQUENCY;
	uint8_t payload[] = {0xDE, 0xAD, 0xBE, 0xEF};

	hubble_init(utc_time, test_key_primary);
	test_seq_override = 42;

	uint8_t output[TEST_ADV_BUFFER_SZ];
	size_t output_len = sizeof(output);

	int ret = hubble_ble_advertise_get(payload, sizeof(payload), output,
					   &output_len);
	zassert_ok(ret);

	struct test_ble_adv_parsed parsed;
	ret = test_parse_ble_adv(output, output_len, &parsed);
	zassert_ok(ret);

	/* Tamper with encrypted data */
	uint8_t tampered_data[HUBBLE_BLE_MAX_DATA_LEN];
	memcpy(tampered_data, parsed.encrypted_data, parsed.encrypted_len);
	tampered_data[0] ^= 0xFF;

	/* Auth tag should fail verification */
	ret = test_verify_auth_tag(test_key_primary, time_counter,
				   test_seq_override, tampered_data,
				   parsed.encrypted_len, parsed.auth_tag);
	zassert_equal(ret, -EBADMSG,
		      "Tampered data should fail auth verification");
}

ZTEST(ble_decrypt_test, test_cross_key_decrypt_fails)
{
	uint32_t time_counter = 20;
	uint64_t utc_time = (uint64_t)time_counter * TIMER_COUNTER_FREQUENCY;
	uint8_t payload[] = {0xDE, 0xAD, 0xBE, 0xEF};

	/* Encrypt with primary key */
	hubble_init(utc_time, test_key_primary);
	test_seq_override = 50;

	uint8_t output[TEST_ADV_BUFFER_SZ];
	size_t output_len = sizeof(output);

	int ret = hubble_ble_advertise_get(payload, sizeof(payload), output,
					   &output_len);
	zassert_ok(ret);

	struct test_ble_adv_parsed parsed;
	ret = test_parse_ble_adv(output, output_len, &parsed);
	zassert_ok(ret);

	/* Try to verify with wrong key - should fail */
	ret = test_verify_auth_tag(test_key_zeros, time_counter,
				   test_seq_override, parsed.encrypted_data,
				   parsed.encrypted_len, parsed.auth_tag);
	zassert_equal(ret, -EBADMSG, "Wrong key should fail auth verification");

	/* Decrypt with wrong key produces garbage (not original) */
	uint8_t decrypted[HUBBLE_BLE_MAX_DATA_LEN];
	ret = test_decrypt_payload(test_key_zeros, time_counter,
				   test_seq_override, parsed.encrypted_data,
				   parsed.encrypted_len, decrypted);
	zassert_ok(ret, "Decryption operation should succeed");

	/* But decrypted data should NOT match original */
	bool matches = (memcmp(decrypted, payload, sizeof(payload)) == 0);
	zassert_false(matches, "Wrong key should not decrypt to original");
}

static void *ble_decrypt_test_setup(void)
{
	test_seq_override = 0;
	return NULL;
}

ZTEST_SUITE(ble_decrypt_test, NULL, ble_decrypt_test_setup, NULL, NULL, NULL);

/*===========================================================================*/
/* Test Suite: ble_derive_test - Key derivation function tests               */
/*===========================================================================*/

ZTEST(ble_derive_test, test_device_id_derivation)
{
	uint32_t time_counter = 20;
	uint64_t utc_time = (uint64_t)time_counter * TIMER_COUNTER_FREQUENCY;

	hubble_init(utc_time, test_key_primary);
	test_seq_override = 0;

	uint8_t output[TEST_ADV_BUFFER_SZ];
	size_t output_len = sizeof(output);

	int ret = hubble_ble_advertise_get(NULL, 0, output, &output_len);
	zassert_ok(ret);

	struct test_ble_adv_parsed parsed;
	ret = test_parse_ble_adv(output, output_len, &parsed);
	zassert_ok(ret);

	/* Verify device_id using test helper */
	uint32_t expected_device_id;
	ret = test_derive_device_id(test_key_primary, time_counter,
				    &expected_device_id);
	zassert_ok(ret);

	zassert_equal(parsed.device_id, expected_device_id,
		      "Device ID derivation mismatch");
}

ZTEST(ble_derive_test, test_nonce_derivation_consistency)
{
	/* Verify nonce derivation produces consistent results */
	uint8_t nonce1[12];
	uint8_t nonce2[12];

	int ret = test_derive_nonce(test_key_primary, 20, 100, nonce1);
	zassert_ok(ret);

	ret = test_derive_nonce(test_key_primary, 20, 100, nonce2);
	zassert_ok(ret);

	zassert_mem_equal(nonce1, nonce2, sizeof(nonce1),
			  "Same inputs should produce same nonce");

	/* Different seq_no should produce different nonce */
	ret = test_derive_nonce(test_key_primary, 20, 101, nonce2);
	zassert_ok(ret);

	zassert_false(memcmp(nonce1, nonce2, sizeof(nonce1)) == 0,
		      "Different seq_no should produce different nonce");
}

ZTEST(ble_derive_test, test_encryption_key_derivation_consistency)
{
	/* Verify encryption key derivation produces consistent results */
	uint8_t enc_key1[CONFIG_HUBBLE_KEY_SIZE];
	uint8_t enc_key2[CONFIG_HUBBLE_KEY_SIZE];

	int ret = test_derive_encryption_key(test_key_primary, 20, 100, enc_key1);
	zassert_ok(ret);

	ret = test_derive_encryption_key(test_key_primary, 20, 100, enc_key2);
	zassert_ok(ret);

	zassert_mem_equal(enc_key1, enc_key2, sizeof(enc_key1),
			  "Same inputs should produce same encryption key");

	/* Different inputs should produce different keys */
	ret = test_derive_encryption_key(test_key_primary, 20, 101, enc_key2);
	zassert_ok(ret);

	zassert_false(
		memcmp(enc_key1, enc_key2, sizeof(enc_key1)) == 0,
		"Different seq_no should produce different encryption key");

	ret = test_derive_encryption_key(test_key_primary, 21, 100, enc_key2);
	zassert_ok(ret);

	zassert_false(memcmp(enc_key1, enc_key2, sizeof(enc_key1)) == 0,
		      "Different time_counter should produce different "
		      "encryption key");
}

ZTEST(ble_derive_test, test_derive_null_checks)
{
	uint32_t device_id;
	uint8_t enc_key[CONFIG_HUBBLE_KEY_SIZE];
	uint8_t nonce[12];

	/* NULL master key should fail */
	int ret = test_derive_device_id(NULL, 20, &device_id);
	zassert_equal(ret, -EINVAL, "NULL key should fail");

	ret = test_derive_encryption_key(NULL, 20, 100, enc_key);
	zassert_equal(ret, -EINVAL, "NULL key should fail");

	ret = test_derive_nonce(NULL, 20, 100, nonce);
	zassert_equal(ret, -EINVAL, "NULL key should fail");

	/* NULL output should fail */
	ret = test_derive_device_id(test_key_primary, 20, NULL);
	zassert_equal(ret, -EINVAL, "NULL output should fail");

	ret = test_derive_encryption_key(test_key_primary, 20, 100, NULL);
	zassert_equal(ret, -EINVAL, "NULL output should fail");

	ret = test_derive_nonce(test_key_primary, 20, 100, NULL);
	zassert_equal(ret, -EINVAL, "NULL output should fail");
}

static void *ble_derive_test_setup(void)
{
	test_seq_override = 0;
	return NULL;
}

ZTEST_SUITE(ble_derive_test, NULL, ble_derive_test_setup, NULL, NULL, NULL);

/*===========================================================================*/
/* Test Suite: ble_parse_test - Advertisement parsing tests                  */
/*===========================================================================*/

ZTEST(ble_parse_test, test_parse_null_checks)
{
	uint8_t dummy[16] = {0};
	struct test_ble_adv_parsed parsed;

	/* NULL adv should fail */
	int ret = test_parse_ble_adv(NULL, sizeof(dummy), &parsed);
	zassert_equal(ret, -EINVAL, "NULL adv should fail");

	/* NULL parsed should fail */
	ret = test_parse_ble_adv(dummy, sizeof(dummy), NULL);
	zassert_equal(ret, -EINVAL, "NULL parsed should fail");
}

ZTEST(ble_parse_test, test_parse_too_short)
{
	uint8_t short_adv[8] = {0};
	struct test_ble_adv_parsed parsed;

	/* Buffer too short for minimum advertisement */
	int ret = test_parse_ble_adv(short_adv, sizeof(short_adv), &parsed);
	zassert_equal(ret, -EINVAL, "Too short buffer should fail");
}

ZTEST(ble_parse_test, test_parse_service_uuid)
{
	uint32_t time_counter = 20;
	uint64_t utc_time = (uint64_t)time_counter * TIMER_COUNTER_FREQUENCY;

	hubble_init(utc_time, test_key_primary);
	test_seq_override = 0;

	uint8_t output[TEST_ADV_BUFFER_SZ];
	size_t output_len = sizeof(output);

	int ret = hubble_ble_advertise_get(NULL, 0, output, &output_len);
	zassert_ok(ret);

	struct test_ble_adv_parsed parsed;
	ret = test_parse_ble_adv(output, output_len, &parsed);
	zassert_ok(ret);

	/* Service UUID should be HUBBLE_BLE_UUID */
	zassert_equal(parsed.service_uuid, HUBBLE_BLE_UUID,
		      "Service UUID should be 0x%04X, got 0x%04X",
		      HUBBLE_BLE_UUID, parsed.service_uuid);
}

ZTEST(ble_parse_test, test_parse_seq_no_encoding)
{
	uint32_t time_counter = 20;
	uint64_t utc_time = (uint64_t)time_counter * TIMER_COUNTER_FREQUENCY;

	hubble_init(utc_time, test_key_primary);

	uint16_t test_seq_nos[] = {0, 1, 255, 256, 512, 1023};

	for (size_t i = 0; i < ARRAY_SIZE(test_seq_nos); i++) {
		test_seq_override = test_seq_nos[i];

		uint8_t output[TEST_ADV_BUFFER_SZ];
		size_t output_len = sizeof(output);

		int ret = hubble_ble_advertise_get(NULL, 0, output, &output_len);
		zassert_ok(ret);

		struct test_ble_adv_parsed parsed;
		ret = test_parse_ble_adv(output, output_len, &parsed);
		zassert_ok(ret);

		zassert_equal(parsed.seq_no, test_seq_nos[i],
			      "Seq_no mismatch: got %u, expected %u",
			      parsed.seq_no, test_seq_nos[i]);
	}
}

static void *ble_parse_test_setup(void)
{
	test_seq_override = 0;
	return NULL;
}

ZTEST_SUITE(ble_parse_test, NULL, ble_parse_test_setup, NULL, NULL, NULL);
```

## src/test_decrypt.c
```c
/*
 * Copyright (c) 2025 Hubble Network, Inc.
 *
 * SPDX-License-Identifier: Apache-2.0
 */

#include "test_decrypt.h"

#include <errno.h>
#include <inttypes.h>
#include <stdio.h>
#include <string.h>

#include <hubble/ble.h>
#include <hubble/port/sys.h>
#include <hubble/port/crypto.h>

#define BITS_PER_BYTE        8
#define BLE_CONTEXT_LEN      12
#define BLE_MESSAGE_LEN      64
#define BLE_NONCE_LEN        12
#define BLE_AUTH_TAG_SIZE    4
#define BLE_ADVERTISE_PREFIX 2
#define BLE_ADDR_SIZE        6

/* Big-endian conversion helper */
#define CPU_TO_BE32(x)                                                         \
	((((x) & 0xff000000) >> 24) | (((x) & 0x00ff0000) >> 8) |              \
	 (((x) & 0x0000ff00) << 8) | (((x) & 0x000000ff) << 24))

/**
 * @brief KBKDF Counter mode implementation (mirrors hubble_ble.c)
 *
 * This is a direct port of the _kbkdf_counter function from hubble_ble.c
 * to enable test code to derive the same keys.
 */
static int _test_kbkdf_counter(const uint8_t *key, const char *label,
			       size_t label_len, const uint8_t *context,
			       size_t context_len, uint8_t *output, size_t olen)
{
	int ret = 0;
	uint8_t prf_output[HUBBLE_AES_BLOCK_SIZE];
	uint8_t message[BLE_MESSAGE_LEN];
	uint32_t counter = 1U;
	uint32_t total = 0U;
	uint8_t separation_byte = 0x00;

	/* Message format: Counter + Label + Context + Length (in bits) */
	uint32_t message_length = sizeof(counter) + label_len +
				  sizeof(separation_byte) + context_len +
				  sizeof(uint32_t);

	/* Check for message length overflow */
	if (message_length >= sizeof(message)) {
		ret = -EINVAL;
		goto exit;
	}

	/* Copy label after the counter */
	memcpy((message + sizeof(counter)), label, label_len);
	/* Separation byte (as defined by the standard) */
	message[sizeof(counter) + label_len] = separation_byte;
	/* Copy the context */
	memcpy((message + sizeof(counter) + label_len + sizeof(separation_byte)),
	       context, context_len);
	/* Length in bits at the end */
	memcpy((message + sizeof(counter) + label_len +
		sizeof(separation_byte) + context_len),
	       (uint8_t *)&(uint32_t){CPU_TO_BE32(olen * BITS_PER_BYTE)},
	       sizeof(uint32_t));

	while (total < olen) {
		size_t remaining = olen - total;

		/* Insert counter into the message */
		memcpy(message, (uint8_t *)&(uint32_t){CPU_TO_BE32(counter)},
		       sizeof(counter));

		/* Perform AES-CMAC with the key and the prepared message */
		ret = hubble_crypto_cmac(key, message, message_length,
					 prf_output);
		if (ret != 0) {
			goto exit;
		}

		/* Copy the output */
		if (remaining > HUBBLE_AES_BLOCK_SIZE) {
			remaining = HUBBLE_AES_BLOCK_SIZE;
		}

		memcpy(output + total, prf_output, remaining);
		total += remaining;
		counter++;
	}

exit:
	/* Clear sensitive information */
	hubble_crypto_zeroize(prf_output, sizeof(prf_output));
	hubble_crypto_zeroize(message, sizeof(message));

	return ret;
}

/**
 * @brief Get derived key for a specific label
 */
static int _test_derived_key_get(const uint8_t *master_key, const char *label,
				 uint32_t counter, uint8_t *output_key)
{
	uint8_t context[BLE_CONTEXT_LEN] = {0};

	snprintf((char *)context, BLE_CONTEXT_LEN, "%" PRIu32, counter);

	return _test_kbkdf_counter(master_key, label, strlen(label), context,
				   strlen((const char *)context), output_key,
				   CONFIG_HUBBLE_KEY_SIZE);
}

/**
 * @brief Get derived value using two-stage key derivation
 */
static int _test_derived_value_get(
	const uint8_t *master_key, const char *key_label,
	const char *value_label, uint32_t time_counter, uint16_t seq_no,
	uint8_t *output_value, uint32_t output_len)
{
	int ret;
	uint8_t context[BLE_CONTEXT_LEN] = {0};
	uint8_t derived_key[CONFIG_HUBBLE_KEY_SIZE] = {0};

	/* First stage: derive key from master key */
	ret = _test_derived_key_get(master_key, key_label, time_counter,
				    derived_key);
	if (ret != 0) {
		goto exit;
	}

	/* Second stage: derive value from derived key */
	snprintf((char *)context, BLE_CONTEXT_LEN, "%u", seq_no);
	ret = _test_kbkdf_counter(derived_key, value_label, strlen(value_label),
				  context, strlen((const char *)context),
				  output_value, output_len);

exit:
	hubble_crypto_zeroize(derived_key, sizeof(derived_key));
	return ret;
}

int test_parse_ble_adv(const uint8_t *adv, size_t len,
		       struct test_ble_adv_parsed *parsed)
{
	if (adv == NULL || parsed == NULL) {
		return -EINVAL;
	}

	/* Minimum length: UUID (2) + addr (6) + auth_tag (4) = 12 bytes */
	if (len < BLE_ADVERTISE_PREFIX + BLE_ADDR_SIZE + BLE_AUTH_TAG_SIZE) {
		return -EINVAL;
	}

	memset(parsed, 0, sizeof(*parsed));

	/* Service UUID (little-endian) */
	parsed->service_uuid = adv[0] | (adv[1] << 8);

	/* Protocol version (6 bits) and seq_no (10 bits) from addr */
	parsed->protocol_version = (adv[2] >> 2) & 0x3F;
	parsed->seq_no = ((adv[2] & 0x03) << 8) | adv[3];

	/* Device ID (4 bytes, little-endian) */
	memcpy(&parsed->device_id, &adv[4], sizeof(parsed->device_id));

	/* Auth tag (4 bytes) */
	memcpy(parsed->auth_tag, &adv[8], BLE_AUTH_TAG_SIZE);

	/* Encrypted data */
	parsed->encrypted_len =
		len - BLE_ADVERTISE_PREFIX - BLE_ADDR_SIZE - BLE_AUTH_TAG_SIZE;
	if (parsed->encrypted_len > 0) {
		memcpy(parsed->encrypted_data, &adv[12], parsed->encrypted_len);
	}

	return 0;
}

int test_decrypt_payload(const uint8_t *master_key, uint32_t time_counter,
			 uint16_t seq_no, const uint8_t *ciphertext,
			 size_t cipher_len, uint8_t *plaintext)
{
	int ret;
	uint8_t encryption_key[CONFIG_HUBBLE_KEY_SIZE] = {0};
	uint8_t nonce[HUBBLE_BLE_NONCE_BUFFER_LEN] = {0};

	if (master_key == NULL || plaintext == NULL) {
		return -EINVAL;
	}

	if (cipher_len == 0) {
		return 0;
	}

	if (ciphertext == NULL) {
		return -EINVAL;
	}

	/* Derive encryption key */
	ret = _test_derived_value_get(master_key, "EncryptionKey", "Key",
				      time_counter, seq_no, encryption_key,
				      sizeof(encryption_key));
	if (ret != 0) {
		goto exit;
	}

	/* Derive nonce */
	ret = _test_derived_value_get(master_key, "NonceKey", "Nonce",
				      time_counter, seq_no, nonce, BLE_NONCE_LEN);
	if (ret != 0) {
		goto exit;
	}

	/* AES-CTR is symmetric - encrypt and decrypt are the same operation */
	ret = hubble_crypto_aes_ctr(encryption_key, nonce, ciphertext,
				    cipher_len, plaintext);

exit:
	hubble_crypto_zeroize(encryption_key, sizeof(encryption_key));
	hubble_crypto_zeroize(nonce, sizeof(nonce));
	return ret;
}

int test_verify_auth_tag(const uint8_t *master_key, uint32_t time_counter,
			 uint16_t seq_no, const uint8_t *ciphertext,
			 size_t cipher_len, const uint8_t expected_tag[4])
{
	int ret;
	uint8_t encryption_key[CONFIG_HUBBLE_KEY_SIZE] = {0};
	uint8_t computed_tag[HUBBLE_AES_BLOCK_SIZE] = {0};

	if (master_key == NULL || expected_tag == NULL) {
		return -EINVAL;
	}

	/* Derive encryption key (CMAC uses the same key) */
	ret = _test_derived_value_get(master_key, "EncryptionKey", "Key",
				      time_counter, seq_no, encryption_key,
				      sizeof(encryption_key));
	if (ret != 0) {
		goto exit;
	}

	/* Compute CMAC over ciphertext */
	ret = hubble_crypto_cmac(encryption_key, ciphertext, cipher_len,
				 computed_tag);
	if (ret != 0) {
		goto exit;
	}

	/* Compare first 4 bytes of CMAC with expected tag */
	if (memcmp(computed_tag, expected_tag, BLE_AUTH_TAG_SIZE) != 0) {
		ret = -EBADMSG;
	}

exit:
	hubble_crypto_zeroize(encryption_key, sizeof(encryption_key));
	hubble_crypto_zeroize(computed_tag, sizeof(computed_tag));
	return ret;
}

int test_derive_device_id(const uint8_t *master_key, uint32_t time_counter,
			  uint32_t *device_id)
{
	uint8_t device_id_bytes[4] = {0};
	int ret;

	if (master_key == NULL || device_id == NULL) {
		return -EINVAL;
	}

	ret = _test_derived_value_get(master_key, "DeviceKey", "DeviceID",
				      time_counter, 0, device_id_bytes,
				      sizeof(device_id_bytes));
	if (ret != 0) {
		return ret;
	}

	/* Device ID is stored as little-endian in the packet */
	memcpy(device_id, device_id_bytes, sizeof(*device_id));

	return 0;
}

int test_derive_encryption_key(const uint8_t *master_key, uint32_t time_counter,
			       uint16_t seq_no, uint8_t *enc_key)
{
	if (master_key == NULL || enc_key == NULL) {
		return -EINVAL;
	}

	return _test_derived_value_get(master_key, "EncryptionKey", "Key",
				       time_counter, seq_no, enc_key,
				       CONFIG_HUBBLE_KEY_SIZE);
}

int test_derive_nonce(const uint8_t *master_key, uint32_t time_counter,
		      uint16_t seq_no, uint8_t nonce[12])
{
	if (master_key == NULL || nonce == NULL) {
		return -EINVAL;
	}

	return _test_derived_value_get(master_key, "NonceKey", "Nonce",
				       time_counter, seq_no, nonce,
				       BLE_NONCE_LEN);
}
```

## src/test_decrypt.h
```c
/*
 * Copyright (c) 2025 Hubble Network, Inc.
 *
 * SPDX-License-Identifier: Apache-2.0
 */

#ifndef TEST_DECRYPT_H
#define TEST_DECRYPT_H

#include <stddef.h>
#include <stdint.h>

#ifdef __cplusplus
extern "C" {
#endif

/**
 * @brief Parsed BLE advertisement components
 */
struct test_ble_adv_parsed {
	uint16_t service_uuid;
	uint8_t protocol_version;
	uint16_t seq_no;
	uint32_t device_id;
	uint8_t auth_tag[4];
	uint8_t encrypted_data[13];
	size_t encrypted_len;
};

/**
 * @brief Parse advertisement buffer into components
 *
 * @param adv Advertisement data buffer
 * @param len Length of advertisement data
 * @param parsed Output structure with parsed components
 *
 * @return 0 on success, negative errno on failure
 */
int test_parse_ble_adv(const uint8_t *adv, size_t len,
		       struct test_ble_adv_parsed *parsed);

/**
 * @brief Decrypt payload given master key and derived parameters
 *
 * Uses the same key derivation as the production code to decrypt
 * ciphertext back to plaintext.
 *
 * @param master_key The master encryption key (CONFIG_HUBBLE_KEY_SIZE bytes)
 * @param time_counter Time counter (utc_time / 86400000)
 * @param seq_no Sequence number used for key derivation
 * @param ciphertext Encrypted data to decrypt
 * @param cipher_len Length of ciphertext
 * @param plaintext Output buffer for decrypted data (must be >= cipher_len)
 *
 * @return 0 on success, negative errno on failure
 */
int test_decrypt_payload(const uint8_t *master_key, uint32_t time_counter,
			 uint16_t seq_no, const uint8_t *ciphertext,
			 size_t cipher_len, uint8_t *plaintext);

/**
 * @brief Verify CMAC authentication tag
 *
 * @param master_key The master encryption key
 * @param time_counter Time counter (utc_time / 86400000)
 * @param seq_no Sequence number used for key derivation
 * @param ciphertext Encrypted data to authenticate
 * @param cipher_len Length of ciphertext
 * @param expected_tag Expected 4-byte authentication tag
 *
 * @return 0 if tag matches, -EBADMSG if tag mismatch, other negative errno on failure
 */
int test_verify_auth_tag(const uint8_t *master_key, uint32_t time_counter,
			 uint16_t seq_no, const uint8_t *ciphertext,
			 size_t cipher_len, const uint8_t expected_tag[4]);

/**
 * @brief Derive device ID from master key and time counter
 *
 * @param master_key The master encryption key
 * @param time_counter Time counter (utc_time / 86400000)
 * @param device_id Output device ID
 *
 * @return 0 on success, negative errno on failure
 */
int test_derive_device_id(const uint8_t *master_key, uint32_t time_counter,
			  uint32_t *device_id);

/**
 * @brief Derive encryption key from master key and parameters
 *
 * @param master_key The master encryption key
 * @param time_counter Time counter (utc_time / 86400000)
 * @param seq_no Sequence number
 * @param enc_key Output encryption key (CONFIG_HUBBLE_KEY_SIZE bytes)
 *
 * @return 0 on success, negative errno on failure
 */
int test_derive_encryption_key(const uint8_t *master_key, uint32_t time_counter,
			       uint16_t seq_no, uint8_t *enc_key);

/**
 * @brief Derive nonce from master key and parameters
 *
 * @param master_key The master encryption key
 * @param time_counter Time counter (utc_time / 86400000)
 * @param seq_no Sequence number
 * @param nonce Output nonce (12 bytes)
 *
 * @return 0 on success, negative errno on failure
 */
int test_derive_nonce(const uint8_t *master_key, uint32_t time_counter,
		      uint16_t seq_no, uint8_t nonce[12]);

#ifdef __cplusplus
}
#endif

#endif /* TEST_DECRYPT_H */
```
