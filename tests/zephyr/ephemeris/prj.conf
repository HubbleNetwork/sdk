## CMakeLists.txt
```
# SPDX-License-Identifier: Apache-2.0

cmake_minimum_required(VERSION 3.20.0)
find_package(Zephyr REQUIRED HINTS $ENV{ZEPHYR_BASE})
project(ephemeris)

FILE(GLOB app_sources src/*.c)
target_sources(app PRIVATE ${app_sources})
```

## prj.conf
```kconfig
CONFIG_ZTEST=y
CONFIG_FPU=y

CONFIG_HUBBLE_SAT_NETWORK=y
```

## src/main.c
```c
/*
 * Copyright (c) 2025 Hubble Network
 *
 * SPDX-License-Identifier: Apache-2.0
 */

#include <hubble/sat/ephemeris.h>
#include <zephyr/types.h>
#include <zephyr/ztest.h>

#define EPHEMERIS_DELTA (3)

struct test_result {
	struct ground_info pos;
	uint64_t start_time;
	uint64_t next_pass_time;
};

static const struct test_result results[] = {
	{{47.0, -122.0}, 1713531547, 1713564682},
	{{47.0, -122.0}, 1713876681, 1713911888},
	{{47.0, -122.0}, 1712041799, 1712048999},
	{{47.0, -122.0}, 1711763288, 1711792766},
	{{47.0, -122.0}, 1713446752, 1713479300},
	{{47.0, -122.0}, 1712224710, 1712310913},
	{{47.0, -122.0}, 1711689906, 1711792766},
	{{47.0, -122.0}, 1713506544, 1713517805},
	{{47.0, -122.0}, 1713338906, 1713347037},
	{{47.0, -122.0}, 1711708097, 1711792766},
	{{47.0, 122.0}, 1713760281, 1713854971},
	{{47.0, 122.0}, 1712068561, 1712077469},
	{{47.0, 122.0}, 1713682621, 1713717026},
	{{47.0, 122.0}, 1712405118, 1712424784},
	{{47.0, 122.0}, 1713082984, 1713113644},
	{{47.0, 122.0}, 1713279632, 1713375498},
	{{47.0, 122.0}, 1712735394, 1712857468},
	{{47.0, 122.0}, 1713025696, 1713028253},
	{{47.0, 122.0}, 1711763177, 1711777027},
	{{47.0, 122.0}, 1713038984, 1713075136},
	{{47.0, 180.0}, 1711465572, 1711503695},
	{{47.0, 180.0}, 1712511962, 1712584198},
	{{47.0, 180.0}, 1713888172, 1713923271},
	{{47.0, 180.0}, 1712072133, 1712112975},
	{{47.0, 180.0}, 1712699256, 1712716484},
	{{47.0, 180.0}, 1713681616, 1713705642},
	{{47.0, 180.0}, 1712919674, 1712925783},
	{{47.0, 180.0}, 1712204544, 1712236895},
	{{47.0, 180.0}, 1713474729, 1713534881},
	{{47.0, 180.0}, 1712244051, 1712283787},
	{{47.0, 0.0}, 1713363476, 1713365455},
	{{47.0, 0.0}, 1712795634, 1712847424},
	{{47.0, 0.0}, 1712607843, 1712624051},
	{{47.0, 0.0}, 1712551927, 1712585540},
	{{47.0, 0.0}, 1712017447, 1712020530},
	{{47.0, 0.0}, 1712668061, 1712670939},
	{{47.0, 0.0}, 1711546857, 1711549251},
	{{47.0, 0.0}, 1712839983, 1712847424},
	{{47.0, 0.0}, 1712348658, 1712367848},
	{{47.0, 0.0}, 1712672465, 1712709449},
	{{-47.0, 180.0}, 1712553559, 1712588386},
	{{-47.0, 180.0}, 1711492632, 1711590614},
	{{-47.0, 180.0}, 1712171215, 1712194189},
	{{-47.0, 180.0}, 1713387771, 1713401110},
	{{-47.0, 180.0}, 1712884892, 1712929970},
	{{-47.0, 180.0}, 1712126431, 1712155677},
	{{-47.0, 180.0}, 1711319210, 1711328661},
	{{-47.0, 180.0}, 1711537505, 1711590614},
	{{-47.0, 180.0}, 1711737205, 1711761445},
	{{-47.0, 180.0}, 1712263951, 1712279594},
	{{-47.0, 0.0}, 1712196858, 1712325143},
	{{-47.0, 0.0}, 1711751269, 1711853896},
	{{-47.0, 0.0}, 1711886563, 1711892411},
	{{-47.0, 0.0}, 1711454812, 1711459639},
	{{-47.0, 0.0}, 1713309858, 1713322763},
	{{-47.0, 0.0}, 1713881539, 1713926120},
	{{-47.0, 0.0}, 1712271449, 1712325143},
	{{-47.0, 0.0}, 1711786717, 1711853896},
	{{-47.0, 0.0}, 1712847208, 1712890120},
	{{-47.0, 0.0}, 1713865520, 1713879240},
	{{0.0, 122.0}, 1712410469, 1712424031},
	{{0.0, 122.0}, 1713608547, 1713679274},
	{{0.0, 122.0}, 1712859271, 1712899410},
	{{0.0, 122.0}, 1713455517, 1713679274},
	{{0.0, 122.0}, 1713391574, 1713417436},
	{{0.0, 122.0}, 1712343900, 1712381328},
	{{0.0, 122.0}, 1711556565, 1711692363},
	{{0.0, 122.0}, 1713812565, 1713850030},
	{{0.0, 122.0}, 1711912354, 1711948601},
	{{0.0, 122.0}, 1713674366, 1713679274},
	{{0.0, 180.0}, 1711762928, 1711894508},
	{{0.0, 180.0}, 1712065556, 1712108031},
	{{0.0, 180.0}, 1713070880, 1713101507},
	{{0.0, 180.0}, 1712781352, 1712888024},
	{{0.0, 180.0}, 1711550187, 1711589863},
	{{0.0, 180.0}, 1712103952, 1712108031},
	{{0.0, 180.0}, 1713166070, 1713406051},
	{{0.0, 180.0}, 1711612941, 1711632571},
	{{0.0, 180.0}, 1711792550, 1711894508},
	{{0.0, 180.0}, 1711310392, 1711419026},
};

static const struct orbit_info orbit = {
	.t0 = 1711296587,
	.n0 = 0.00017559780215620866,     /* orbital frequency in orbits/sec */
	.ndot = 3.6984685877857914e-14,
	.raan0 = -2.62346138227064,
	.raandot = 1.992330418167161e-07, /* approximation */
	.aop0 = 3.523598389978097,
	.aopdot = -6.981828658074634e-07, /* approximation */
	.inclination = 97.4608,
	.eccentricity = 0.0010652
};

ZTEST(satellite_ephemeris_test, test_satellite_ephemeris_calculation)
{
	int ret;
	struct hubble_pass_info next_pass;

	for (uint16_t count = 0; count < ARRAY_SIZE(results); count++) {
		ret = hubble_next_pass_get(&orbit, results[count].start_time,
					   &(results[count].pos), &next_pass);

		zassert_equal(ret, 0, NULL);
		zassert_within(next_pass.t, results[count].next_pass_time,
			       EPHEMERIS_DELTA);
	}
}

ZTEST(satellite_ephemeris_test, test_satellite_ephemeris_invalid)
{
	struct hubble_pass_info next_pass;
	int ret;

	ret = hubble_next_pass_get(NULL, results[0].start_time,
				   &(results[0].pos), &next_pass);
	zassert_equal(ret, -EINVAL, NULL);

	ret = hubble_next_pass_get(&orbit, results[0].start_time, NULL,
				   &next_pass);
	zassert_equal(ret, -EINVAL, NULL);

	ret = hubble_next_pass_get(&orbit, results[0].start_time,
				   &(results[0].pos), NULL);
	zassert_equal(ret, -EINVAL, NULL);
}

struct test_region_result {
	struct ground_region_info region;
	uint64_t start_time;
	uint64_t next_pass_time;
	uint32_t duration;
};

static const struct test_region_result region_results[] = {
	{{1.0, 30.0, -45.0, 50.0}, 1711296587, 1711299181, 477},
	{{1.0, 30.0, -45.0, 50.0}, 1711299181, 1711336226, 479},
	{{-45.0, 30.0, -45.0, 50.0}, 1711296587, 1711299912, 482},
	{{-45.0, 30.0, -45.0, 50.0}, 1711335912, 1711341182, 484},
	{{45.0, 30.0, -45.0, 50.0}, 1711296587, 1711298475, 483},
	{{45.0, 30.0, -45.0, 50.0}, 1711334475, 1711336929, 484},
};

ZTEST(satellite_ephemeris_test, test_satellite_ephemeris_region_calculation)
{
	int ret;
	struct hubble_pass_info next_pass;

	for (uint16_t count = 0; count < ARRAY_SIZE(region_results); count++) {
		ret = hubble_next_pass_region_get(
			&orbit, region_results[count].start_time,
			&(region_results[count].region), &next_pass);

		zassert_equal(ret, 0, NULL);
		zassert_within(next_pass.t, region_results[count].next_pass_time,
			       EPHEMERIS_DELTA);
		zassert_within(next_pass.duration,
			       region_results[count].duration, EPHEMERIS_DELTA);
	}
}

ZTEST_SUITE(satellite_ephemeris_test, NULL, NULL, NULL, NULL, NULL);
```
